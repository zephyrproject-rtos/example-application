## Kconfig
```
# Copyright (c) 2021 Nordic Semiconductor ASA
# SPDX-License-Identifier: Apache-2.0

mainmenu "Bluetooth: Peripheral HT"

if HAS_HW_NRF_TEMP

config SENSOR
	default y

config TEMP_NRF5
	default y

endif # HAS_HW_NRF_TEMP

source "Kconfig.zephyr"
```

## prj.conf
```kconfig
CONFIG_BT=y
CONFIG_LOG=y
CONFIG_BT_SMP=y
CONFIG_BT_PERIPHERAL=y
CONFIG_BT_DIS=y
CONFIG_BT_DIS_PNP=n
CONFIG_BT_BAS=y
CONFIG_BT_DEVICE_NAME="quentin"
CONFIG_BT_DEVICE_APPEARANCE=768
CONFIG_CBPRINTF_FP_SUPPORT=y

CONFIG_BUTTON_LIB=y
```

## src/main.c
```c
#include <zephyr/types.h>
#include <stddef.h>
#include <string.h>
#include <errno.h>
#include <zephyr/sys/printk.h>
#include <zephyr/sys/byteorder.h>
#include <zephyr/kernel.h>

#include <zephyr/bluetooth/bluetooth.h>
#include <zephyr/bluetooth/hci.h>
#include <zephyr/bluetooth/conn.h>
#include <zephyr/bluetooth/uuid.h>
#include <zephyr/bluetooth/gatt.h>
#include <zephyr/bluetooth/services/bas.h>

#include "hts.h"
#include "button_irq.h"
#include <button_lib/button_lib.h>

uint8_t flag=0;

/*---Define all the uses for the four boutons------------------------------------------------------------------*/
#define SW0_NODE	DT_ALIAS(sw0)
static const struct gpio_dt_spec button0 = GPIO_DT_SPEC_GET_OR(SW0_NODE, gpios, {0});
static struct gpio_callback button0_cb;
/*--------------------------------------------------------------------------------------------------------------*/


static const struct bt_data ad[] = {
	BT_DATA_BYTES(BT_DATA_FLAGS, (BT_LE_AD_GENERAL | BT_LE_AD_NO_BREDR)),
	BT_DATA_BYTES(BT_DATA_UUID16_ALL, BT_UUID_16_ENCODE(BT_UUID_UDS_VAL)),
};

static void connected(struct bt_conn *conn, uint8_t err)
{
	if (err) {
		printk("Connection failed (err 0x%02x)\n", err);
	} else {
		printk("Connected\n");
	}
}

static void disconnected(struct bt_conn *conn, uint8_t reason)
{
	printk("Disconnected (reason 0x%02x)\n", reason);
}

BT_CONN_CB_DEFINE(conn_callbacks) = {
	.connected = connected,
	.disconnected = disconnected,
};

static void bt_ready(void)
{
	int err;
	err=bt_enable(NULL);
	if(err)printk("Bluetooth failed\n");

	err = bt_le_adv_start(BT_LE_ADV_CONN_NAME, ad, ARRAY_SIZE(ad), NULL, 0);
	if (err) {
		printk("Advertising failed to start (err %d)\n", err);
		return;
	}

	printk("Advertising successfully started\n");
}

static void auth_cancel(struct bt_conn *conn)
{
	char addr[BT_ADDR_LE_STR_LEN];

	bt_addr_le_to_str(bt_conn_get_dst(conn), addr, sizeof(addr));

	printk("Pairing cancelled: %s\n", addr);
}

static struct bt_conn_auth_cb auth_cb_display = {
	.cancel = auth_cancel,
};




int main(void)
{
	button_init(&button0);
    isr_btn_config(&button0, isr_ble, &button0_cb, GPIO_INT_EDGE_RISING);

	bt_ready();

	bt_conn_auth_cb_register(&auth_cb_display);

	/* Implement indicate. At the moment there is no suitable way
	 * of starting delayed work so we do it here
	 */
	while (1) {
		//val1 = button_state(&button1);
		printk("\n Valeur : %d",flag);
		hts_indicate(&flag);
		k_msleep(10);
	}
	return 0;
}
```

## src/button_irq.c
```c
#include "button_irq.h"

#include <zephyr/kernel.h>
#include <zephyr/device.h>
#include <zephyr/drivers/gpio.h>
#include <zephyr/sys/util.h>
#include <zephyr/sys/printk.h>
#include <inttypes.h>

extern uint8_t flag;

void isr_ble(const struct device *dev, struct gpio_callback *cb,
		    uint32_t pins)
{
	flag=!flag;
}
```

## src/button_irq.h
```c
#include <zephyr/kernel.h>
#include <zephyr/device.h>
#include <zephyr/drivers/gpio.h>
#include <zephyr/sys/util.h>
#include <zephyr/sys/printk.h>
#include <inttypes.h>


void isr_ble(const struct device *dev, struct gpio_callback *cb,
		    uint32_t pins);
```

## src/hts.c
```c
#include <stdio.h>
#include <stddef.h>
#include <string.h>
#include <errno.h>

#include <zephyr/kernel.h>
#include <zephyr/drivers/sensor.h>
#include <zephyr/sys/printk.h>
#include <zephyr/sys/byteorder.h>

#include <zephyr/bluetooth/bluetooth.h>
#include <zephyr/bluetooth/hci.h>
#include <zephyr/bluetooth/conn.h>
#include <zephyr/bluetooth/uuid.h>
#include <zephyr/bluetooth/gatt.h>

#include "hts.h"


static uint8_t simulate_htm;
static uint8_t indicating;
static struct bt_gatt_indicate_params ind_params;

//static uint16_t val_envoyee = 0xABCD; //Valeur qu'on souhaite envoyer


// Regarde si la valeur à envoyer à changer
static void htmc_ccc_cfg_changed(const struct bt_gatt_attr *attr, uint16_t value){
	simulate_htm = (value == BT_GATT_CCC_INDICATE) ? 1 : 0;  //le changement de la valeur de la caractéristique sera indicate
}


//Indique que l'indicate a été réussie ou non
static void indicate_cb(struct bt_conn *conn,
						struct bt_gatt_indicate_params *params, uint8_t err){
	printk("Indication %s\n", err != 0U ? "fail" : "success");
}


//Indique que l'indicate a été effectuée
static void indicate_destroy(struct bt_gatt_indicate_params *params){
	//Une fois l'indicate fini on remet indicating=0 afin de pouvoir refaire un indicate.
	printk("Indication complete\n");
	indicating = 0U;
}



/* Declaration du service USER_DATA */
BT_GATT_SERVICE_DEFINE(usr_data_svc,
	BT_GATT_PRIMARY_SERVICE(BT_UUID_UDS),														//User Data Service
	BT_GATT_CHARACTERISTIC(	BT_UUID_GATT_DO,													//Digital Output
							BT_GATT_CHRC_INDICATE | BT_GATT_CHRC_READ | BT_GATT_CHRC_WRITE,     //Permissions
							BT_GATT_PERM_READ , 
							NULL, 
							NULL, 
							NULL),

	//Client Characteristic Configuration Declaration Macro.														   
	BT_GATT_CCC(htmc_ccc_cfg_changed, BT_GATT_PERM_READ | BT_GATT_PERM_WRITE),
);



// Dans le main on arrive sur cette fonction qui regarde si la valeur à envoyer à changé puis l'envoie si oui.
void hts_indicate(uint8_t* val)
{
	if (simulate_htm) {
		static uint8_t htm[5];

		if (indicating) {
			return;
		}

		goto gatt_indicate;

gatt_indicate:
		// Mise à jour des paramètres
		ind_params.attr = &usr_data_svc.attrs[2];
		ind_params.func = indicate_cb;
		ind_params.destroy = indicate_destroy;
		ind_params.data = val;//&htm;
		ind_params.len = sizeof(*val);//sizeof(htm);
		printk("\n VALEUR VAL : %d",*val);
		// On envoie les nouvelles valeurs en Bluetooth
		if (bt_gatt_indicate(NULL, &ind_params) == 0) {
			indicating = 1U;
		}
	}
}
```

## src/hts.h
```c
/** @file
 *  @brief HTS Service sample
 */

/*
 * Copyright (c) 2019 Aaron Tsui <aaron.tsui@outlook.com>
 *
 * SPDX-License-Identifier: Apache-2.0
 */

#ifdef __cplusplus
extern "C" {
#endif

void hts_init(void);
void hts_indicate(uint8_t*);

#ifdef __cplusplus
}
#endif
```
