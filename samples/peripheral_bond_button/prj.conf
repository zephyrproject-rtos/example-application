## prj.conf
```kconfig
CONFIG_BT=y
CONFIG_LOG=y
CONFIG_BT_SMP=y
CONFIG_BT_PERIPHERAL=y
CONFIG_BT_DIS=y
CONFIG_BT_DIS_PNP=n
CONFIG_BT_BAS=y
CONFIG_BT_DEVICE_NAME="Zephyr WLHT"
CONFIG_BT_DEVICE_APPEARANCE=768
CONFIG_CBPRINTF_FP_SUPPORT=y


CONFIG_BT_SIGNING=y
CONFIG_BT_ATT_PREPARE_COUNT=1
# CONFIG_BT_PRIVACY=y

CONFIG_BT_KEYS_OVERWRITE_OLDEST=y
CONFIG_BT_SETTINGS=y
CONFIG_BT_FILTER_ACCEPT_LIST=y
CONFIG_FLASH=y
CONFIG_FLASH_PAGE_LAYOUT=y
CONFIG_FLASH_MAP=y
CONFIG_NVS=y
CONFIG_SETTINGS=y
CONFIG_REBOOT=y

CONFIG_BUTTON_LIB=y
CONFIG_LED_LIB=y
```

## src/main.c
```c
/*
 * Copyright (c) 2022 Michal Morsisko
 * Copyright (c) 2015-2016 Intel Corporation
 *
 * SPDX-License-Identifier: Apache-2.0
 */

#include <zephyr/types.h>
#include <stddef.h>
#include <zephyr/sys/printk.h>
#include <zephyr/sys/reboot.h>
#include <zephyr/settings/settings.h>
#include <zephyr/bluetooth/bluetooth.h>
#include <zephyr/bluetooth/conn.h>
#include <zephyr/bluetooth/uuid.h>
#include <zephyr/bluetooth/gatt.h>

#include <button_lib/button_lib.h>
#include <led_lib/led_lib.h>

#include "bond_periph.h"

#define SW0_NODE	DT_ALIAS(sw0)
static const struct gpio_dt_spec button0 = GPIO_DT_SPEC_GET_OR(SW0_NODE, gpios, {0});
#define LED0_NODE DT_ALIAS(led0)
static const struct gpio_dt_spec led0 = GPIO_DT_SPEC_GET(LED0_NODE, gpios);


/* Custom Service Variables */
#define BT_UUID_CUSTOM_SERVICE_VAL \
	BT_UUID_128_ENCODE(0x12345678, 0x1234, 0x5678, 0x1234, 0x56789abcdef0)

static const struct bt_uuid_128 primary_service_uuid = BT_UUID_INIT_128(
	BT_UUID_CUSTOM_SERVICE_VAL);

static const struct bt_uuid_128 read_characteristic_uuid = BT_UUID_INIT_128(
	BT_UUID_128_ENCODE(0x12345678, 0x1234, 0x5678, 0x1234, 0x56789abcdef1));

static const struct bt_uuid_128 write_characteristic_uuid = BT_UUID_INIT_128(
	BT_UUID_128_ENCODE(0x12345678, 0x1234, 0x5678, 0x1234, 0x56789abcdef2));

static int signed_value;


static ssize_t read_signed(struct bt_conn *conn, const struct bt_gatt_attr *attr,
			   void *buf, uint16_t len, uint16_t offset)
{
	int *value = &signed_value;

	return bt_gatt_attr_read(conn, attr, buf, len, offset, value,
				 sizeof(signed_value));
}

static ssize_t write_signed(struct bt_conn *conn, const struct bt_gatt_attr *attr,
			    const void *buf, uint16_t len, uint16_t offset,
			    uint8_t flags)
{
	int *value = &signed_value;

	if (offset + len > sizeof(signed_value)) {
		return BT_GATT_ERR(BT_ATT_ERR_INVALID_OFFSET);
	}

	memcpy(value + offset, buf, len);

	return len;
}

/* Vendor Primary Service Declaration */
BT_GATT_SERVICE_DEFINE(primary_service,
	BT_GATT_PRIMARY_SERVICE(&primary_service_uuid),
	BT_GATT_CHARACTERISTIC(&read_characteristic_uuid.uuid,
			       BT_GATT_CHRC_READ,
			       BT_GATT_PERM_READ,
			       read_signed, NULL, NULL),
	BT_GATT_CHARACTERISTIC(&write_characteristic_uuid.uuid,
			       BT_GATT_CHRC_WRITE,
			       BT_GATT_PERM_WRITE_ENCRYPT,
			       NULL, write_signed, NULL),
);

////////////////////////////////////////////////////////////////////////////////////////////////

struct bt_le_adv_param adv_param;

const struct bt_data ad[] = {
	BT_DATA_BYTES(BT_DATA_FLAGS, (BT_LE_AD_GENERAL | BT_LE_AD_NO_BREDR))
};

const struct bt_data sd[] = {
	BT_DATA_BYTES(BT_DATA_UUID128_ALL, BT_UUID_CUSTOM_SERVICE_VAL)
};
/////////////////////////////////////////////////////

static void connected(struct bt_conn *conn, uint8_t err)
{
	if (err) {
		printk("Connection failed (err 0x%02x)\n", err);
	} else {
		printk("Connected\n");
	}
}

static void disconnected(struct bt_conn *conn, uint8_t reason)
{
	printk("Disconnected (reason 0x%02x)\n", reason);
}

BT_CONN_CB_DEFINE(conn_callbacks) = {
	.connected = connected,
	.disconnected = disconnected
};


static void bt_ready(void)
{
	int err;

	printk("Bluetooth initialized\n");

	if (IS_ENABLED(CONFIG_SETTINGS)) {
		settings_load();
	}

	ble_bond_init(NULL, NULL);

	adv_param = *BT_LE_ADV_CONN_NAME;
	adv_param.options |= BT_LE_ADV_OPT_FILTER_CONN | BT_LE_ADV_OPT_FILTER_SCAN_REQ;
	err = bt_le_adv_start(&adv_param, ad, ARRAY_SIZE(ad), sd, ARRAY_SIZE(sd));

	if (err) {
		printk("Advertising failed to start (err %d)\n", err);
	} else {
		printk("Advertising successfully started\n");
	}


}


int main(void)
{ 
	int err;

	button_init(&button0);
    led_init(&led0);

	err = bt_enable(NULL);
	if (err) {
		printk("Bluetooth init failed (err %d)\n", err);
		return 0;
	}

	bt_ready();
	

	printk("\tClick on button to bond or wait 5s\n");
	int i=0;
	while(i<500 && !button_state(&button0)){
		k_sleep(K_MSEC(10));
		i++;
	}
	if(button_state(&button0)){
		printk("\tDetectable\n");
		err = ble_bond_1_conn(ad, ARRAY_SIZE(ad), sd, ARRAY_SIZE(sd));
		if(err != 0){
			printk("Error bonding : %d\n", err);
			return err;
		}
	}

	printk("Sending data..\n");
	
	return 0;
}
```

## src/bond_periph.c
```c
#include "bond_periph.h"

static struct bt_le_adv_param adv_param;
static int bond_count;

void pairing_complete(struct bt_conn *conn, bool bonded)
{
	printk("Pairing completed. Rebooting...\n");
	sys_reboot(SYS_REBOOT_WARM);
}

static struct bt_conn_auth_info_cb bt_conn_auth_info = {
	.pairing_complete = pairing_complete
};

static void add_bonded_addr_to_filter_list(const struct bt_bond_info *info, void *data)
{
	char addr_str[BT_ADDR_LE_STR_LEN];

	bt_le_filter_accept_list_add(&info->addr);
	bt_addr_le_to_str(&info->addr, addr_str, sizeof(addr_str));
	bond_count++;
}

void ble_bond_init(void (*func)(const struct bt_bond_info *info, void *user_data), void *user_data){
	if (func == NULL)
	{
		bt_foreach_bond(BT_ID_DEFAULT, add_bonded_addr_to_filter_list, user_data);
	}
	else{
		bt_foreach_bond(BT_ID_DEFAULT, func, user_data);
	}

	bt_conn_auth_info_cb_register(&bt_conn_auth_info);
	adv_param = *BT_LE_ADV_CONN_NAME;
}

int ble_bond_start(const struct bt_data* ad, int ad_size, const struct bt_data* sd, int sd_size){
	int err;
	err = bt_le_adv_stop();
	if (err) {
		return err;
	}

	adv_param.options &= ~(BT_LE_ADV_OPT_FILTER_CONN | BT_LE_ADV_OPT_FILTER_SCAN_REQ);
	err = bt_le_adv_start(&adv_param, ad, ad_size, sd, sd_size);

	if (err) {
		return err;
	}
	return 0;
}

int ble_bond_stop(const struct bt_data* ad, int ad_size, const struct bt_data* sd, int sd_size){
	int err;
	err = bt_le_adv_stop();
	if (err) {
		return err;
	}
	adv_param.options |= (BT_LE_ADV_OPT_FILTER_CONN | BT_LE_ADV_OPT_FILTER_SCAN_REQ);
	err = bt_le_adv_start(&adv_param, ad, ad_size, sd, sd_size);

	if (err) {
		return err;
	}
	return 0;
}

int ble_bond_duration(uint8_t duration, const struct bt_data* ad, int ad_size, const struct bt_data* sd, int sd_size){
	int err;
	err = ble_bond_start(ad, ad_size, sd, sd_size);
	if(err != 0){
		return err;
	}
	bond_count = 0;
	while (bond_count == 0 && duration > 0){
		k_sleep(K_SECONDS(1));
		duration--;
	}
	err = ble_bond_stop(ad, ad_size, sd, sd_size);
	if(err != 0){
		return err;
	}
	return 0;
}

int ble_bond_1_conn(const struct bt_data* ad, int ad_size, const struct bt_data* sd, int sd_size){
	int err;
	err = ble_bond_start(ad, ad_size, sd, sd_size);
	if(err != 0){
		return err;
	}
	bond_count = 0;
	while (bond_count == 0){
		k_sleep(K_SECONDS(1));
	}
	err = ble_bond_stop(ad, ad_size, sd, sd_size);
	if(err != 0){
		return err;
	}
	return 0;
}
```

## src/bond_periph.h
```c
/**
 * \file bond_periph.h
 * \brief peripheral bond library
 * \author Johan P.
*/


#ifndef BOND_PERIPH_H
#define BOND_PERIPH_H

#include <zephyr/types.h>
#include <stddef.h>
#include <zephyr/sys/printk.h>
#include <zephyr/sys/reboot.h>
#include <zephyr/settings/settings.h>
#include <zephyr/bluetooth/bluetooth.h>
#include <zephyr/bluetooth/conn.h>
#include <zephyr/bluetooth/uuid.h>
#include <zephyr/bluetooth/gatt.h>

/**
 * 
 * \brief Redirects pairing request to function  
 * \param func Function to process pairing request. If NULL, there is default function
 * \param user_data User data for function
*/
void ble_bond_init(void (*func)(const struct bt_bond_info *info, void *user_data), void *user_data);

/**
 * \brief Start bonding
 * \param ad structure for advertising
 * \param  ad_size size of ad
 * \param  sd structure for advertising
 * \param  sd_size size of sd
 * \return 0 if no error or error code
*/
int ble_bond_start(const struct bt_data* ad, int ad_size, const struct bt_data* sd, int sd_size);

/**
 * \brief Stop bonding
 * \param ad structure for advertising
 * \param  ad_size size of ad
 * \param  sd structure for advertising
 * \param  sd_size size of sd
 * \return 0 if no error or error code
*/
int ble_bond_stop(const struct bt_data* ad, int ad_size, const struct bt_data* sd, int sd_size);

/**
 * \brief Activates bonding during argument time or until there isn't connection.
 * \param duration maximum seconds of bonding
 * \param ad structure for advertising
 * \param  ad_size size of ad
 * \param  sd structure for advertising
 * \param  sd_size size of sd
 * \return 0 if no error or error code
*/
int ble_bond_duration(uint8_t duration, const struct bt_data* ad, int ad_size, const struct bt_data* sd, int sd_size);

/**
 * \brief Activates bonding until there isn't connection.
 * \param ad structure for advertising
 * \param  ad_size size of ad
 * \param  sd structure for advertising
 * \param  sd_size size of sd
 * \return 0 if no error or error code
*/
int ble_bond_1_conn(const struct bt_data* ad, int ad_size, const struct bt_data* sd, int sd_size);

#endif
```
