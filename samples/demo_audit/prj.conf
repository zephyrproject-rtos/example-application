## prj.conf
```kconfig
CONFIG_BLE_LIB=y
CONFIG_BUTTON_LIB=y
CONFIG_LED_LIB=y

CONFIG_BT=y
CONFIG_LOG=y
CONFIG_BT_SMP=y
CONFIG_BT_PERIPHERAL=y
CONFIG_BT_DEVICE_NAME="quentin bluetooth"
CONFIG_BT_DEVICE_APPEARANCE=768
CONFIG_CBPRINTF_FP_SUPPORT=y
CONFIG_BT_GATT_CLIENT=y
CONFIG_BT_CENTRAL=y
<<<<<<< HEAD
CONFIG_BT_DIS=y

CONFIG_HEAP_MEM_POOL_SIZE=8192
CONFIG_SYSTEM_WORKQUEUE_STACK_SIZE=8192


CONFIG_BT_ATT_TX_COUNT=10




=======
CONFIG_BT_DIS=y
>>>>>>> main
```

## src/main.c
```c
#include <ble_lib/ble_lib.h>
#include <button_lib/button_lib.h>
#include <led_lib/led_lib.h>
#include "service.h"
#include "gpios_init.h"
<<<<<<< HEAD
#include <stdio.h>
#include <stddef.h>
#include <errno.h>

#include <zephyr/kernel.h>
#include <zephyr/sys/printk.h>
#include <zephyr/sys/byteorder.h>

#include <zephyr/bluetooth/bluetooth.h>
#include <zephyr/bluetooth/hci.h>
#include <zephyr/bluetooth/conn.h>
#include <zephyr/bluetooth/uuid.h>
#include <zephyr/bluetooth/gatt.h>

static struct bt_conn *default_conn;
static struct bt_uuid_16 discover_uuid = BT_UUID_INIT_16(0);
static struct bt_gatt_discover_params discover_params;

struct bt_conn* connect;
int first_attr;

bool etat_boutton = 1;
struct Ble_Data etat_boutton_struct={
	.data=&etat_boutton,
	.size=sizeof(etat_boutton)
};

/*--------------Fonction de callback qui s'éxecute lorsqu'une valeur est indicate -------------
------------------et qui fait l'affichage de la valeur reçue, et la stocke ------------------*/
static uint8_t val_received(struct bt_conn *conn,
			   struct bt_gatt_subscribe_params *params,
			   const void *data, uint16_t length)
{
	if (!data) {
		printk("[UNSUBSCRIBED]\n");
		params->value_handle = 0U;
		return BT_GATT_ITER_STOP;
	}

	printk("Donnée reçue : attr %d\n", params->value_handle);
	return BT_GATT_ITER_CONTINUE;
}




#define NB_CHAR 50
struct bt_gatt_subscribe_params subscribe_params_array[NB_CHAR];
int char_index = 0;





static uint8_t discover_func_test(struct bt_conn *conn,
			     const struct bt_gatt_attr *attr,
			     struct bt_gatt_discover_params *params)
{
	if (!attr) {
		if (discover_params.type == BT_GATT_DISCOVER_PRIMARY){
			bt_conn_disconnect(conn, BT_HCI_ERR_REMOTE_USER_TERM_CONN);
		}
		printk("Discover complete\n");
		(void)memset(params, 0, sizeof(*params));
		return BT_GATT_ITER_STOP;
	}

	int err;

	if (discover_params.type != BT_GATT_DISCOVER_CHARACTERISTIC){
		struct bt_gatt_subscribe_params *subscribe_params = &subscribe_params_array[char_index];
		subscribe_params->value_handle = (attr->handle) + 2;
		subscribe_params->notify = val_received;
		subscribe_params->value = BT_GATT_CCC_INDICATE;
		subscribe_params->ccc_handle = (attr->handle) + 3;

		err = bt_gatt_subscribe(conn, subscribe_params);
		if (err && err != -EALREADY) {
			printk("Subscribe failed (err %d)\n", err);
		} 
		else {
			printk("[SUBSCRIBED]\n");
		}

		discover_params.uuid = NULL;
		discover_params.start_handle = (attr->handle) + 4;
		discover_params.type = BT_GATT_DISCOVER_CHARACTERISTIC;
		discover_params.func = discover_func_test;
		discover_params.end_handle = BT_ATT_LAST_ATTRIBUTE_HANDLE;

		err = bt_gatt_discover(default_conn, &discover_params);
		if (err) {
			printk("Discover failed(err %d)\n", err);
			return;
		}
	}
	else{
		struct bt_gatt_subscribe_params *subscribe_params = &subscribe_params_array[char_index];
		subscribe_params->value_handle = (attr->handle) + 1;
		subscribe_params->notify = val_received;
		subscribe_params->value = BT_GATT_CCC_INDICATE;
		subscribe_params->ccc_handle = (attr->handle) + 2;

		err = bt_gatt_subscribe(conn, subscribe_params);
		if (err && err != -EALREADY) {
			printk("Subscribe failed (err %d)\n", err);
		} 
		else {
			printk("[SUBSCRIBED]\n");
		}

		discover_params.uuid = NULL;
		discover_params.start_handle = (attr->handle) + 1;
		discover_params.type = BT_GATT_DISCOVER_CHARACTERISTIC;
		discover_params.func = discover_func_test;
		discover_params.end_handle = BT_ATT_LAST_ATTRIBUTE_HANDLE;

		err = bt_gatt_discover(default_conn, &discover_params);
		if (err) {
			printk("Discover failed(err %d)\n", err);
			return;
		}
		
	}
	char_index++;
	return BT_GATT_ITER_STOP;
}


void discover_gatt_service(uint16_t service_UUID)
{
	int err;
	memcpy(&discover_uuid, BT_UUID_DECLARE_16(service_UUID), sizeof(discover_uuid));
	discover_params.uuid = &discover_uuid.uuid;
	discover_params.func = discover_func_test;
	discover_params.start_handle = BT_ATT_FIRST_ATTRIBUTE_HANDLE;
	discover_params.end_handle = BT_ATT_LAST_ATTRIBUTE_HANDLE;
	discover_params.type = BT_GATT_DISCOVER_PRIMARY;

	err = bt_gatt_discover(default_conn, &discover_params);
	if (err) {
		printk("Discover failed(err %d)\n", err);
		return;
	}
}



=======

static const struct bt_data ad[] = {
	BT_DATA_BYTES(BT_DATA_FLAGS, (BT_LE_AD_GENERAL | BT_LE_AD_NO_BREDR)),
	BT_DATA_BYTES(BT_DATA_UUID16_ALL,BT_UUID_16_ENCODE(BT_UUID_UDS_VAL)),
};

struct bt_conn* connect;
>>>>>>> main

static void connected(struct bt_conn *conn, uint8_t err)
{
	if (err) {
<<<<<<< HEAD
	} 
	else{
		printk("connetced\n;");
		connect=conn;
		discover_gatt_service(BT_UUID_UDS_VAL);
	}
}



/*--- Fonction de callback qui s'exécute lorsqu'on a trouvé un device auquel on peut se connecter ---*/
/*--- Test si ce device utilise le service qu'on recherche, avec lequel on souhaite communiquer -----*/
static bool eir_found(struct bt_data *data, void *user_data)
{
	bt_addr_le_t *addr = user_data;
	int i;

	printk("[AD]: %u data_len %u\n", data->type, data->data_len);

	switch (data->type) {
	case BT_DATA_UUID16_SOME:
	case BT_DATA_UUID16_ALL:
		if (data->data_len % sizeof(uint16_t) != 0U) {
			printk("AD malformed\n");
			return true;
		}

		for (i = 0; i < data->data_len; i += sizeof(uint16_t)) {
			const struct bt_uuid *uuid;
			uint16_t u16;
			int err;

			/*On récupère chaque 16 bits reçus un par un, on les copie dans u16*/
			memcpy(&u16, &data->data[i], sizeof(u16));

			/*On recupère l'UUID formé avec ces 16 bits*/
			uuid = BT_UUID_DECLARE_16(sys_le16_to_cpu(u16));

			/*On compare si cet UUID le même que celui qu'on veut*/
			if (bt_uuid_cmp(uuid, BT_UUID_UDS)) {
				/*Si ce n'est pas le même on passe à l'itération suivante*/
				continue;
			}

			/*Si c'est le même, on arrête le bt_scan*/
			err = bt_le_scan_stop();
			if (err) {
				printk("Stop LE scan failed (err %d)\n", err);
				continue;
			}

			/*On essaye de se connecter à ce device puisqu'il envoie une donnée avec l'UUID qu'on cherche*/
			err = bt_conn_le_create(addr, BT_CONN_LE_CREATE_CONN, BT_LE_CONN_PARAM_DEFAULT, &default_conn);
			if (err) {
				printk("Create connection failed (err %d)\n", err);
				/*Si erreur de connexion on recommence à scanner*/
				//scan_start();
			}

			return false;
		}
	}

	return true;
}


/*--- Fonction de callback qui s'exécute lorsqu'un device est détecté pendant le scan ----*/
static void device_found(const bt_addr_le_t *addr, int8_t rssi, uint8_t type,
			 struct net_buf_simple *ad)
{
	char dev[BT_ADDR_LE_STR_LEN];

	/* Si le signal n'est pas assez fort (appareil trop loin), on passe */
	if (rssi > -40){
		bt_addr_le_to_str(addr, dev, sizeof(dev));
		printk("[DEVICE]: %s, AD evt type %u, AD data len %u, RSSI %i\n",
			dev, type, ad->len, rssi);

	
		/* We're only interested in connectable events */
		if (type == BT_HCI_ADV_IND || type == BT_HCI_ADV_DIRECT_IND) {
			bt_data_parse(ad, eir_found, (void *)addr);
		}
	}
}


/* ------------- Fontion qui active le scan avec certains paramètres ------------------ */
static int scan_start(void)
{
	/* Use active scanning and disable duplicate filtering to handle any
	 * devices that might update their advertising data at runtime.
	 */
	struct bt_le_scan_param scan_param = {
		.type       = BT_LE_SCAN_TYPE_ACTIVE,
		.options    = BT_LE_SCAN_OPT_NONE,
		.interval   = BT_GAP_SCAN_FAST_INTERVAL,
		.window     = BT_GAP_SCAN_FAST_WINDOW,
	};

	return bt_le_scan_start(&scan_param, device_found);
}



static void disconnected(struct bt_conn *conn, uint8_t reason)
{
	printk("Disconnected\n");
=======
		
	} else {
		printk("CONNECTED\n");
		bt_le_adv_stop();
		connect=conn;
	}
}

static void disconnected(struct bt_conn *conn, uint8_t reason)
{
>>>>>>> main
}

BT_CONN_CB_DEFINE(conn_callbacks) = {
	.connected = connected,
	.disconnected = disconnected,
};

<<<<<<< HEAD







int main(void){
	int err;
	printk("NULL :%d\n", NULL==default_conn );
=======
int main(void){
>>>>>>> main
	button_init(&button0);
    isr_btn_config(&button0, button0_isr, &button0_cb, GPIO_INT_EDGE_BOTH);
	button_init(&button1);
    isr_btn_config(&button1, button1_isr, &button1_cb, GPIO_INT_EDGE_BOTH);
	button_init(&button2);
    isr_btn_config(&button2, button2_isr, &button2_cb, GPIO_INT_EDGE_BOTH);
	button_init(&button3);
    isr_btn_config(&button3, button3_isr, &button3_cb, GPIO_INT_EDGE_BOTH);

	led_init(&led0);
	led_init(&led1);
	led_init(&led2);
	led_init(&led3);

	ble_enable();
<<<<<<< HEAD
	/*------ Démarrage du scan pour chercher les peripheral ----*/
	err = scan_start();
	if (err) {
		printk("Scanning failed to start (err %d)\n", err);
		return 0;
	}
	printk("Scanning successfully started\n");
	/*----------------------------------------------------------*/
	k_msleep(3000);
=======
	ble_advertise_start_conn(ad, ARRAY_SIZE(ad), NULL, 0);
	//k_msleep(3000);
>>>>>>> main
	while(1){
		led_set(&led0,button_led0);
		led_set(&led1,button_led1);
		led_set(&led2,button_led2);
		led_set(&led3,button_led3);
<<<<<<< HEAD
		k_msleep(1);
=======
		k_msleep(1000); 
>>>>>>> main
	}
	

	return 0;
}

void button0_isr(const struct device *dev, struct gpio_callback *cb,
		    uint32_t pins)
{
<<<<<<< HEAD
	ble_write(connect, &etat_boutton_struct, first_attr);

=======
	button_led0=false;
	if(button_state(&button0)){
		button_led0=true;
	}
	ble_write(connect, &button_led0_struct, 1);
>>>>>>> main
}

void button1_isr(const struct device *dev, struct gpio_callback *cb,
		    uint32_t pins)
{
<<<<<<< HEAD
	ble_write(connect, &etat_boutton_struct, first_attr+4);
=======
	button_led1=false;
	if(button_state(&button1)){
		button_led1=true;
	}
	ble_write(connect, &button_led1_struct, 5);
>>>>>>> main
}

void button2_isr(const struct device *dev, struct gpio_callback *cb,
		    uint32_t pins)
{
<<<<<<< HEAD
	ble_write(connect, &etat_boutton_struct, first_attr+8);
=======
	button_led2=false;
	if(button_state(&button2)){
		button_led2=true;
	}
	ble_write(connect, &button_led2_struct, 9);
>>>>>>> main
}

void button3_isr(const struct device *dev, struct gpio_callback *cb,
		    uint32_t pins)
{
<<<<<<< HEAD
	ble_write(connect, &etat_boutton_struct, first_attr+12);
=======
	button_led3=false;
	if(button_state(&button3)){
		button_led3=true;
	}
	ble_write(connect, &button_led3_struct, 14);
>>>>>>> main
}
```

## src/gpios_init.h
```c
#include <button_lib/button_lib.h>
#include <led_lib/led_lib.h>

#define SW0_NODE	DT_ALIAS(sw0)
static const struct gpio_dt_spec button0 = GPIO_DT_SPEC_GET_OR(SW0_NODE, gpios, {0});
static struct gpio_callback button0_cb;
void button0_isr(const struct device *dev, struct gpio_callback *cb, uint32_t pins);
#define SW1_NODE	DT_ALIAS(sw1)
static const struct gpio_dt_spec button1 = GPIO_DT_SPEC_GET_OR(SW1_NODE, gpios, {1});
static struct gpio_callback button1_cb;
void button1_isr(const struct device *dev, struct gpio_callback *cb, uint32_t pins);
#define SW2_NODE	DT_ALIAS(sw2)
static const struct gpio_dt_spec button2 = GPIO_DT_SPEC_GET_OR(SW2_NODE, gpios, {2});
static struct gpio_callback button2_cb;
void button2_isr(const struct device *dev, struct gpio_callback *cb, uint32_t pins);
#define SW3_NODE	DT_ALIAS(sw3)
static const struct gpio_dt_spec button3 = GPIO_DT_SPEC_GET_OR(SW3_NODE, gpios, {3});
static struct gpio_callback button3_cb;
void button3_isr(const struct device *dev, struct gpio_callback *cb, uint32_t pins);

#define LED0_NODE DT_ALIAS(led0)
static const struct gpio_dt_spec led0 = GPIO_DT_SPEC_GET(LED0_NODE, gpios);
#define LED1_NODE DT_ALIAS(led1)
static const struct gpio_dt_spec led1 = GPIO_DT_SPEC_GET(LED1_NODE, gpios);
#define LED2_NODE DT_ALIAS(led2)
static const struct gpio_dt_spec led2 = GPIO_DT_SPEC_GET(LED2_NODE, gpios);
#define LED3_NODE DT_ALIAS(led3)
static const struct gpio_dt_spec led3 = GPIO_DT_SPEC_GET(LED3_NODE, gpios);
```

## src/service.h
```c
#ifndef SERVICE_H
#define SERVICE_H

#include<ble_lib/ble_lib.h>

bool button_led0;
struct Ble_Data button_led0_struct={
	.data=&button_led0,
	.size=sizeof(button_led0)
};

bool button_led1;
struct Ble_Data button_led1_struct={
	.data=&button_led1,
	.size=sizeof(button_led1)
};

bool button_led2;
struct Ble_Data button_led2_struct={
	.data=&button_led2,
	.size=sizeof(button_led2)
};

bool button_led3;
struct Ble_Data button_led3_struct={
	.data=&button_led3,
	.size=sizeof(button_led3)
};


BT_GATT_SERVICE_DEFINE(userdata_svc,

	BT_GATT_PRIMARY_SERVICE(BT_UUID_UDS),

	BT_GATT_CHARACTERISTIC(BT_UUID_GATT_DO, BT_GATT_CHRC_INDICATE | BT_GATT_CHRC_READ| BT_GATT_CHRC_WRITE, BT_GATT_PERM_READ | BT_GATT_PERM_WRITE, read_fonction_callback, write_fonction_callback, &button_led0_struct),
	BT_GATT_CCC(ccc_cfg_changed, BT_GATT_PERM_READ | BT_GATT_PERM_WRITE),
	BT_GATT_CPF(NULL),

	BT_GATT_CHARACTERISTIC(BT_UUID_GATT_DO, BT_GATT_CHRC_INDICATE | BT_GATT_CHRC_READ| BT_GATT_CHRC_WRITE, BT_GATT_PERM_READ  | BT_GATT_PERM_WRITE, read_fonction_callback, write_fonction_callback, &button_led1_struct),
	BT_GATT_CCC(ccc_cfg_changed, BT_GATT_PERM_READ | BT_GATT_PERM_WRITE),
	BT_GATT_CPF(NULL),

	BT_GATT_CHARACTERISTIC(BT_UUID_GATT_DO, BT_GATT_CHRC_INDICATE | BT_GATT_CHRC_READ| BT_GATT_CHRC_WRITE, BT_GATT_PERM_READ | BT_GATT_PERM_WRITE , read_fonction_callback, write_fonction_callback, &button_led2_struct),
	BT_GATT_CCC(ccc_cfg_changed, BT_GATT_PERM_READ | BT_GATT_PERM_WRITE),
	BT_GATT_CPF(NULL),

	BT_GATT_CHARACTERISTIC(BT_UUID_GATT_DO, BT_GATT_CHRC_INDICATE | BT_GATT_CHRC_READ| BT_GATT_CHRC_WRITE, BT_GATT_PERM_READ | BT_GATT_PERM_WRITE, read_fonction_callback, write_fonction_callback, &button_led3_struct),
	BT_GATT_CCC(ccc_cfg_changed, BT_GATT_PERM_READ | BT_GATT_PERM_WRITE),
	BT_GATT_CPF(NULL),
);


#endif
```
