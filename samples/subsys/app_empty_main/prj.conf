## CMakeLists.txt
```
# SPDX-License-Identifier: Apache-2.0

cmake_minimum_required(VERSION 3.13.1)

find_package(Zephyr REQUIRED HINTS $ENV{ZEPHYR_BASE})
project(app_empty_main)

target_sources(app PRIVATE src/main.c)
```

## sample.yaml
```
sample:
  description: App Empty Main, sample made entirely from
    subsystems and drivers, and no console output
  name: App Empty Main
common:
    tags: introduction
    integration_platforms:
      - native_posix
    harness: console
    harness_config:
      type: one_line
      regex:
      - "\\[.*\\] .*<inf> custom_subsys: Hello from \"example-application\".*"
tests:
  sample.basic.app_empty_main:
    tags: introduction
```

## prj.conf
```kconfig
CONFIG_BOOT_BANNER=n
CONFIG_CUSTOM_SUBSYS=y
```

## src/main.c
```c
/*
 * Copyright (c) 2021 Legrand North America, LLC.
 *
 * SPDX-License-Identifier: Apache-2.0
 */

#include <zephyr/kernel.h>

void main(void)
{
	/* Do nothing here.  Leave for test code. */
}
```
