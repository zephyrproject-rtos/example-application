## CMakeLists.txt
```
# SPDX-License-Identifier: Apache-2.0

cmake_minimum_required(VERSION 3.13.1)

find_package(Zephyr REQUIRED HINTS $ENV{ZEPHYR_BASE})
project(module_hello)

target_sources(app PRIVATE src/main.c)
```

## sample.yaml
```
sample:
  description: Module Hello sample, application made entirely from
    subsystems and drivers
  name: module hello
common:
    tags: introduction
    integration_platforms:
      - native_posix
tests:
  sample.basic.hello-module:
    tags: introduction
```

## prj.conf
```kconfig
CONFIG_MODULE_HELLO=y
```

## src/main.c
```c
/*
 * Copyright (c) 2021 Legrand North America, LLC.
 *
 * SPDX-License-Identifier: Apache-2.0
 */

#include <zephyr.h>

void main(void)
{
	/* Do nothing here.  Leave for test code. */
}
```
