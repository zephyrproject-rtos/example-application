## CMakeLists.txt
```
# SPDX-License-Identifier: Apache-2.0

cmake_minimum_required(VERSION 3.20.0)

find_package(Zephyr REQUIRED HINTS $ENV{ZEPHYR_BASE})
project(led_lib)


FILE(GLOB app_sources src/*.c)
target_sources(app PRIVATE ${app_sources})
```

## prj.conf
```kconfig
CONFIG_LED_LIB=y
```

## src/main.c
```c
#include <led_lib/led_lib.h>

#include <zephyr/kernel.h>
#include <zephyr/device.h>
#include <zephyr/drivers/gpio.h>
#include <zephyr/sys/util.h>
#include <zephyr/sys/printk.h>
#include <inttypes.h>

/* 1000 msec = 1 sec */
#define SLEEP_TIME_MS   1000

/* The devicetree node identifier for the "led0" alias. */
#define LED0_NODE DT_ALIAS(led0)

static const struct gpio_dt_spec led0 = GPIO_DT_SPEC_GET(LED0_NODE, gpios);
/*
static const struct gpio_dt_spec leds[] =  {GPIO_DT_SPEC_GET(LED0_NODE, gpios),
                                            GPIO_DT_SPEC_GET(LED1_NODE, gpios),
                                            GPIO_DT_SPEC_GET(LED2_NODE, gpios),
                                            GPIO_DT_SPEC_GET(LED3_NODE, gpios)
                                            };*/


int main() {
    
    led_init(&led0);

    while (1) {
        led_set(&led0,OFF);
    }

    return 0;
}
```
