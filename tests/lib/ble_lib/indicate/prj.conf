## prj.conf
```kconfig
CONFIG_BLE_LIB=y
CONFIG_BUTTON_LIB=y
CONFIG_LED_LIB=y

CONFIG_BT=y
CONFIG_LOG=y
CONFIG_BT_SMP=y
CONFIG_BT_PERIPHERAL=y
CONFIG_BT_DEVICE_NAME="quentin bluetooth"
CONFIG_BT_DEVICE_APPEARANCE=768
CONFIG_CBPRINTF_FP_SUPPORT=y
CONFIG_BT_GATT_CLIENT=y
CONFIG_BT_PERIPHERAL=y
```

## src/main.c
```c
#include <ble_lib/ble_lib.h>
#include <button_lib/button_lib.h>
#include <led_lib/led_lib.h>
#include "service.h"
#include "gpios_init.h"


struct bt_uuid_16 discover_uuid = BT_UUID_INIT_16(0);
struct bt_gatt_discover_params discover_params;
struct bt_gatt_subscribe_params subscribe_params;


static const struct bt_data ad[] = {
	//BT_DATA_BYTES(BT_DATA_FLAGS, (BT_LE_AD_GENERAL | BT_LE_AD_NO_BREDR)),
	BT_DATA_BYTES(BT_DATA_UUID16_ALL,BT_UUID_16_ENCODE(BT_UUID_UDS_VAL)),
};

static uint8_t val_received(struct bt_conn *conn,
			   struct bt_gatt_subscribe_params *params,
			   const void *data, uint16_t length)
{
	int i;
	if (!data) {
		printk("[UNSUBSCRIBED]\n");
		params->value_handle = 0U;
		return BT_GATT_ITER_STOP;
	}

	printk("Donnée reçue :");
	for (i=0; i<length; i++){
		printk("%d ", *((uint8_t*)data));
	}
	printk("\n");
	return BT_GATT_ITER_CONTINUE;
}

uint8_t discover_func(struct bt_conn *conn,
			     const struct bt_gatt_attr *attr,
			     struct bt_gatt_discover_params *params)
{
	int err;

	if (!attr) {
		printk("Discover complete\n");
		(void)memset(params, 0, sizeof(*params));
		return BT_GATT_ITER_STOP;
	}

	printk("[ATTRIBUTE] handle %u\n", attr->handle);
	

	/*Si l'UUID qu'on a dans discover est celui du service qu'on souhaite, on rentre*/
	if (!bt_uuid_cmp(discover_params.uuid, BT_UUID_UDS)) {

		memcpy(&discover_uuid, BT_UUID_GATT_DO, sizeof(discover_uuid));
		discover_params.uuid = &discover_uuid.uuid;
		discover_params.start_handle = attr->handle + 1;
		discover_params.type = BT_GATT_DISCOVER_CHARACTERISTIC;

		err = bt_gatt_discover(conn, &discover_params);
		if (err) {
			printk("Discover failed (err %d)\n", err);
		}
	} 
	
	/*Si l'UUID qu'on a dans discover est celui de la characteristic qu'on souhaite, on rentre*/
	else if (!bt_uuid_cmp(discover_params.uuid, BT_UUID_GATT_DO)) {
		memcpy(&discover_uuid, BT_UUID_GATT_CCC, sizeof(discover_uuid));
		discover_params.uuid = &discover_uuid.uuid;
		discover_params.start_handle = attr->handle + 2;
		discover_params.type = BT_GATT_DISCOVER_DESCRIPTOR;
		subscribe_params.value_handle = bt_gatt_attr_value_handle(attr);

		err = bt_gatt_discover(conn, &discover_params);
		if (err) {
			printk("Discover failed (err %d)\n", err);
		}
	} 
	
	else {
		subscribe_params.notify = val_received;
		subscribe_params.value = BT_GATT_CCC_INDICATE;
		subscribe_params.ccc_handle = attr->handle;

		err = bt_gatt_subscribe(conn, &subscribe_params);
		if (err && err != -EALREADY) {
			printk("Subscribe failed (err %d)\n", err);
		} else {
			printk("[SUBSCRIBED]\n");
		}
		
		return BT_GATT_ITER_STOP;
	}

	return BT_GATT_ITER_STOP;
}

static struct bt_conn *connect;

static void connected(struct bt_conn *conn, uint8_t err)
{
	if (err) {
		led_blink(&led0, 100);
		
	} else {
		led_set(&led0, HIGH);
		connect=conn;
		bt_le_adv_stop();

		memcpy(&discover_uuid, BT_UUID_UDS, sizeof(discover_uuid));
		discover_params.uuid = &discover_uuid.uuid;
		discover_params.func = discover_func;
		discover_params.start_handle = BT_ATT_FIRST_ATTRIBUTE_HANDLE;
		discover_params.end_handle = BT_ATT_LAST_ATTRIBUTE_HANDLE;
		discover_params.type = BT_GATT_DISCOVER_PRIMARY;
		int err = bt_gatt_discover(connect, &discover_params);
	}
}




static void disconnected(struct bt_conn *conn, uint8_t reason)
{
	led_set(&led0, LOW);
}

BT_CONN_CB_DEFINE(conn_callbacks) = {
	.connected = connected,
	.disconnected = disconnected,
};

int main(void){
	uint8_t val=15;
	struct Ble_Data val_info={
		.data=&val,
		.size=sizeof(val)
	};
	button_init(&button0);
    isr_btn_config(&button0, button0_isr, &button0_cb, GPIO_INT_EDGE_BOTH);
	led_init(&led0);
	ble_enable();
	ble_advertise_start_conn(ad, ARRAY_SIZE(ad), NULL, 0);

		


	
	k_msleep(3000);
	while(1){
		//ble_write(connect, &val_info, subscribe_params.value_handle);
		k_msleep(100);
	}
	

	return 0;
}

void button0_isr(const struct device *dev, struct gpio_callback *cb,
		    uint32_t pins)
{
	button0_val=false;
	if(button_state(&button0)){
		button0_val=true;
	}
	ble_indicate(&button0_struct, gpios_svc, 1);
}

/*NOTE : interet du indicate*/

/*
Le indicate permet de signaler des données TR
EN effet le indicate est utile pour des boutons par exemple, sur interruption
la centrale n'a pas a constamment interroger le service bouton pour connaitre son état
*/
```

## src/data.h
```c
#ifndef DATA_H
#define DATA_H

#include<ble_lib/ble_lib.h>
#include <zephyr/types.h>
#include <stddef.h>
#include <string.h>
#include <stdint.h>
#include <errno.h>
#include <zephyr/sys/printk.h>
#include <zephyr/sys/byteorder.h>
#include <zephyr/kernel.h>

#include <zephyr/settings/settings.h>

#include <zephyr/bluetooth/bluetooth.h>
#include <zephyr/bluetooth/hci.h>
#include <zephyr/bluetooth/conn.h>
#include <zephyr/bluetooth/uuid.h>
#include <zephyr/bluetooth/gatt.h>

bool button0_val;

struct Ble_Data button0_struct={
	.data=&button0_val,
	.size=sizeof(bool)
};

char led0_cb[4];
bool led1_cb;
bool led2_cb;
bool led3_cb;


struct Ble_Data led0_cb_info = {
    .size = sizeof(led0_cb),
    .data = led0_cb,
};


// Déclaration du Format de Profil Caractéristique (GATT_CPF)
static const struct bt_gatt_cpf type1 = {
	.format = 0x01,        /* bool */
	.exponent = 0x0,
	.unit = 0x2700,        /* Unitless */
	.name_space = 0x01,    /* Bluetooth SIG */
	.description = 0x0001, /* "first characteristic" */
};

BT_GATT_SERVICE_DEFINE(userdata_svc,

	BT_GATT_PRIMARY_SERVICE(BT_UUID_UDS),
	
	BT_GATT_CHARACTERISTIC(BT_UUID_GATT_DO, BT_GATT_CHRC_INDICATE | BT_GATT_CHRC_READ, BT_GATT_PERM_READ , read_fonction_callback, write_fonction_callback, &button0_struct),
	BT_GATT_CCC(ccc_cfg_changed, BT_GATT_PERM_READ | BT_GATT_PERM_WRITE),
	BT_GATT_CPF(&type1),

	BT_GATT_CHARACTERISTIC(BT_UUID_GATT_DO, BT_GATT_CHRC_INDICATE | BT_GATT_CHRC_WRITE | BT_GATT_CHRC_READ, BT_GATT_PERM_WRITE | BT_GATT_PERM_READ , read_fonction_callback, write_fonction_callback, &led0_cb_info),
	BT_GATT_CCC(ccc_cfg_changed, BT_GATT_PERM_READ | BT_GATT_PERM_WRITE),
	BT_GATT_CPF(&type1),
/*
	BT_GATT_CHARACTERISTIC(BT_UUID_GATT_DO, BT_GATT_CHRC_INDICATE | BT_GATT_CHRC_WRITE, BT_GATT_PERM_WRITE , read_fonction_callback, write_fonction_callback, &led1_cb),
	BT_GATT_CCC(ccc_cfg_changed, BT_GATT_PERM_READ | BT_GATT_PERM_WRITE),
	BT_GATT_CPF(&type1),

	BT_GATT_CHARACTERISTIC(BT_UUID_GATT_DO, BT_GATT_CHRC_INDICATE | BT_GATT_CHRC_WRITE, BT_GATT_PERM_WRITE , read_fonction_callback, write_fonction_callback, &led2_cb),
	BT_GATT_CCC(ccc_cfg_changed, BT_GATT_PERM_READ | BT_GATT_PERM_WRITE),
	BT_GATT_CPF(&type1),

	BT_GATT_CHARACTERISTIC(BT_UUID_GATT_DO, BT_GATT_CHRC_INDICATE | BT_GATT_CHRC_WRITE, BT_GATT_PERM_WRITE , read_fonction_callback, write_fonction_callback, &led3_cb),
	BT_GATT_CCC(ccc_cfg_changed, BT_GATT_PERM_READ | BT_GATT_PERM_WRITE),
	BT_GATT_CPF(&type1),*/
);

#endif
```

## src/gpios_init.h
```c
#include <button_lib/button_lib.h>
#include <led_lib/led_lib.h>

#define SW0_NODE	DT_ALIAS(sw0)
static const struct gpio_dt_spec button0 = GPIO_DT_SPEC_GET_OR(SW0_NODE, gpios, {0});
static struct gpio_callback button0_cb;
void button0_isr(const struct device *dev, struct gpio_callback *cb, uint32_t pins);

#define LED0_NODE DT_ALIAS(led0)
static const struct gpio_dt_spec led0 = GPIO_DT_SPEC_GET(LED0_NODE, gpios);
#define LED1_NODE DT_ALIAS(led1)
static const struct gpio_dt_spec led1 = GPIO_DT_SPEC_GET(LED1_NODE, gpios);
#define LED2_NODE DT_ALIAS(led2)
static const struct gpio_dt_spec led2 = GPIO_DT_SPEC_GET(LED2_NODE, gpios);
#define LED3_NODE DT_ALIAS(led3)
static const struct gpio_dt_spec led3 = GPIO_DT_SPEC_GET(LED3_NODE, gpios);
```

## src/service.h
```c
#ifndef SERVICE_H
#define SERVICE_H

#include<ble_lib/ble_lib.h>

bool button0_val;
struct Ble_Data button0_struct={
	.data=&button0_val,
	.size=sizeof(button0_val)
};

char led0_cb[26];
struct Ble_Data led0_cb_info = {
    .size = sizeof(led0_cb),
    .data = led0_cb,
};

uint8_t age_cb=24;
struct Ble_Data age_cb_info = {
    .size = sizeof(age_cb),
    .data = &age_cb,
};

char name_cb[30]="Julien";
struct Ble_Data name_cb_info = {
    .size = sizeof(name_cb),
    .data = name_cb,
};

char email_cb[]="quentin89.caldeira@gmail.com";
struct Ble_Data email_cb_info = {
    .size = sizeof(email_cb),
    .data = email_cb,
};




// Déclaration du Format de Profil Caractéristique (GATT_CPF)
static const struct bt_gatt_cpf type1 = {
	.format = 0x01,        /* bool */
	.exponent = 0x0,
	.unit = 0x2700,        /* Unitless */
	.name_space = 0x01,    /* Bluetooth SIG */
	.description = 0x0001, /* "first characteristic" */
};

BT_GATT_SERVICE_DEFINE(gpios_svc,

	BT_GATT_PRIMARY_SERVICE(BT_UUID_UDS),

	BT_GATT_CHARACTERISTIC(BT_UUID_GATT_DO, BT_GATT_CHRC_INDICATE | BT_GATT_CHRC_READ, BT_GATT_PERM_READ , read_fonction_callback, write_fonction_callback, &button0_struct),
	BT_GATT_CCC(ccc_cfg_changed, BT_GATT_PERM_READ | BT_GATT_PERM_WRITE),
	BT_GATT_CPF(NULL),
/*
	BT_GATT_CHARACTERISTIC(BT_UUID_GATT_AO, BT_GATT_CHRC_INDICATE | BT_GATT_CHRC_WRITE | BT_GATT_CHRC_READ, BT_GATT_PERM_WRITE | BT_GATT_PERM_READ , read_fonction_callback, write_fonction_callback, &led0_cb_info),
	BT_GATT_CCC(ccc_cfg_changed, BT_GATT_PERM_READ | BT_GATT_PERM_WRITE),
	BT_GATT_CPF(&type1),

	BT_GATT_CHARACTERISTIC(BT_UUID_GATT_DO, BT_GATT_CHRC_INDICATE | BT_GATT_CHRC_WRITE | BT_GATT_CHRC_READ, BT_GATT_PERM_WRITE | BT_GATT_PERM_READ , read_fonction_callback, write_fonction_callback, &led0_cb_info),
	BT_GATT_CCC(ccc_cfg_changed, BT_GATT_PERM_READ | BT_GATT_PERM_WRITE),
	BT_GATT_CPF(&type1),

	BT_GATT_CHARACTERISTIC(BT_UUID_GATT_DO, BT_GATT_CHRC_INDICATE | BT_GATT_CHRC_WRITE | BT_GATT_CHRC_READ, BT_GATT_PERM_WRITE | BT_GATT_PERM_READ , read_fonction_callback, write_fonction_callback, &led0_cb_info),
	BT_GATT_CCC(ccc_cfg_changed, BT_GATT_PERM_READ | BT_GATT_PERM_WRITE),
	BT_GATT_CPF(&type1),*/
);
/*
BT_GATT_SERVICE_DEFINE(userdata_svc,

	BT_GATT_PRIMARY_SERVICE(BT_UUID_UDS),
	
	BT_GATT_CHARACTERISTIC(BT_UUID_GATT_AGE, BT_GATT_CHRC_READ, BT_GATT_PERM_READ , read_fonction_callback, write_fonction_callback, &age_cb_info),
	BT_GATT_CCC(ccc_cfg_changed, BT_GATT_PERM_READ),
	BT_GATT_CPF(NULL),

	BT_GATT_CHARACTERISTIC(BT_UUID_GATT_FIRST_NAME, BT_GATT_CHRC_READ, BT_GATT_PERM_READ , read_fonction_callback, write_fonction_callback, &name_cb_info),
	BT_GATT_CCC(ccc_cfg_changed, BT_GATT_PERM_READ),
	BT_GATT_CPF(NULL),

	BT_GATT_CHARACTERISTIC(BT_UUID_GATT_EMAIL, BT_GATT_CHRC_READ, BT_GATT_PERM_READ , read_fonction_callback, write_fonction_callback, &email_cb_info),
	BT_GATT_CCC(ccc_cfg_changed, BT_GATT_PERM_READ),
	BT_GATT_CPF(NULL),
);
*/

#endif
```
