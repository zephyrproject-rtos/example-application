## CMakeLists.txt
```
# SPDX-License-Identifier: Apache-2.0

cmake_minimum_required(VERSION 3.20.0)

find_package(Zephyr REQUIRED HINTS $ENV{ZEPHYR_BASE})
project(ble_lib)

FILE(GLOB app_sources src/*.c)
target_sources(app PRIVATE ${app_sources})
```

## prj.conf
```kconfig
CONFIG_BLE_LIB=y

CONFIG_BT=y
CONFIG_BT_PRIVACY=y
CONFIG_BT_DEVICE_NAME="quentin"
CONFIG_BT_DEVICE_APPEARANCE=833
CONFIG_BT_DEVICE_NAME_DYNAMIC=y
CONFIG_BT_DEVICE_NAME_MAX=65
```

## src/main.c
```c
#include <ble_lib/ble_lib.h>
#include "data.h"

int main() {
    ble_advertise_start_nconn(ad, ARRAY_SIZE(ad), NULL, 0);*
    return 0;
}
```
