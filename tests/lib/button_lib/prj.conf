## CMakeLists.txt
```
# SPDX-License-Identifier: Apache-2.0

cmake_minimum_required(VERSION 3.20.0)

find_package(Zephyr REQUIRED HINTS $ENV{ZEPHYR_BASE})
project(button_lib)

FILE(GLOB app_sources src/*.c)
target_sources(app PRIVATE ${app_sources})



set(ZEPHYR_EXTRA_MODULES "/home/jordan/Documents/PFE_2/pfe/modules")
set(BOARD_ROOT "/home/jordan/Documents/PFE_2/pfe")
```

## sample.yaml
```
sample:
  name: Bluetooth Peripheral HT
  description: Demonstrates the HT (Health Thermometer) GATT Service
tests:
  sample.bluetooth.peripheral_ht:
    harness: bluetooth
    platform_allow:
      - qemu_cortex_m3
      - qemu_x86
      - nrf51dk_nrf51422
      - nrf52dk_nrf52832
    tags: bluetooth
    integration_platforms:
      - qemu_cortex_m3
      - qemu_x86
  sample.bluetooth.peripheral_ht.frdm_kw41z_shield:
    harness: bluetooth
    platform_allow:
      - mimxrt1020_evk
      - mimxrt1050_evk
      - mimxrt1060_evk
      - frdm_k64f
    tags: bluetooth
    extra_args: SHIELD=frdm_kw41z
    integration_platforms:
      - mimxrt1020_evk
```

## prj.conf
```kconfig
CONFIG_BUTTON_LIB=y
CONFIG_GPIO=y
```

## src/main.c
```c
#include <button_lib/button_lib.h>
#include "button_irq.h"

#include <zephyr/kernel.h>
#include <zephyr/device.h>
#include <zephyr/drivers/gpio.h>
#include <zephyr/sys/util.h>
#include <zephyr/sys/printk.h>
#include <inttypes.h>

#define SLEEP_TIME_MS	1

#define SW0_NODE	DT_ALIAS(sw0)
static const struct gpio_dt_spec button0 = GPIO_DT_SPEC_GET_OR(SW0_NODE, gpios, {0});
static struct gpio_callback button0_cb;
#define SW1_NODE	DT_ALIAS(sw1)
static const struct gpio_dt_spec button1 = GPIO_DT_SPEC_GET_OR(SW1_NODE, gpios, {1});
static struct gpio_callback button1_cb;
#define SW2_NODE	DT_ALIAS(sw2)
static const struct gpio_dt_spec button2 = GPIO_DT_SPEC_GET_OR(SW2_NODE, gpios, {2});
static struct gpio_callback button2_cb;
#define SW3_NODE	DT_ALIAS(sw3)
static const struct gpio_dt_spec button3 = GPIO_DT_SPEC_GET_OR(SW3_NODE, gpios, {3});
static struct gpio_callback button3_cb;

int main() {
    button_init(&button0);
    isr_btn_config(&button0, test_a, &button0_cb, GPIO_INT_EDGE_RISING);
    button_init(&button1);
    isr_btn_config(&button1, test_b, &button1_cb, GPIO_INT_EDGE_BOTH);
    button_init(&button2);
    isr_btn_config(&button2, test_c, &button2_cb, GPIO_INT_EDGE_FALLING);
    button_init(&button3);
    isr_btn_config(&button3, test_d, &button3_cb, GPIO_INT_EDGE_BOTH);
    while (1);
    return 0;
}
```

## src/button_irq.c
```c
#include "button_irq.h"

#include <zephyr/kernel.h>
#include <zephyr/device.h>
#include <zephyr/drivers/gpio.h>
#include <zephyr/sys/util.h>
#include <zephyr/sys/printk.h>
#include <inttypes.h>


void test_a(const struct device *dev, struct gpio_callback *cb,
		    uint32_t pins)
{
	printk("test a\n");
}

void test_b(const struct device *dev, struct gpio_callback *cb,
		    uint32_t pins)
{
	printk("test_b\n");
}

void test_c(const struct device *dev, struct gpio_callback *cb,
		    uint32_t pins)
{
	printk("test_c\n");
}

void test_d(const struct device *dev, struct gpio_callback *cb,
		    uint32_t pins)
{
	printk("test_d\n");
}
```

## src/button_irq.h
```c
#include <zephyr/kernel.h>
#include <zephyr/device.h>
#include <zephyr/drivers/gpio.h>
#include <zephyr/sys/util.h>
#include <zephyr/sys/printk.h>
#include <inttypes.h>


void test_a(const struct device *dev, struct gpio_callback *cb,
		    uint32_t pins);

void test_b(const struct device *dev, struct gpio_callback *cb,
		    uint32_t pins);

void test_c(const struct device *dev, struct gpio_callback *cb,
		    uint32_t pins);

void test_d(const struct device *dev, struct gpio_callback *cb,
		    uint32_t pins);
```
