## west.yml
```yaml
# Copyright (c) 2021 Nordic Semiconductor ASA
# SPDX-License-Identifier: Apache-2.0

manifest:
  self:
    west-commands: scripts/west-commands.yml

  remotes:
    - name: zephyrproject-rtos
      url-base: https://github.com/zephyrproject-rtos

  projects:
    - name: zephyr
      remote: zephyrproject-rtos
      revision: main
      import:
        # By using name-allowlist we can clone only the modules that are
        # strictly needed by the application.
        name-allowlist:
          - cmsis_6    # required by the ARM port for Cortex-M
          - hal_nordic # required by the custom_plank board (Nordic based)
          - hal_stm32  # required by the nucleo_f302r8 board (STM32 based)
```

## zephyr/projects/zxa_example_project/sample.yaml
```yaml
sample:
  description: Example of the simplest <module> project
  name: ZXA Example Project
common:
    tags: introduction
    harness: console
    harness_config:
      type: one_line
      regex:
        - "(.*)<inf> zxa: Hello from zxa_example_project!"
tests:
  project.zxa_example_project:
    tags: introduction
```
