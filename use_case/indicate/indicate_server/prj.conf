## sample.yaml
```
sample:
  name: Bluetooth centrale write
tests:
  sample.bluetooth.central_write:
    harness: bluetooth
    platform_allow:
      - qemu_cortex_m3
      - qemu_x86
      - nrf51dk_nrf51422
      - nrf52dk_nrf52832
    tags: bluetooth
    integration_platforms:
      - qemu_cortex_m3
      - qemu_x86
```

## prj.conf
```kconfig
CONFIG_BLE_LIB=y
CONFIG_BUTTON_LIB=y
CONFIG_LED_LIB=y

CONFIG_BT=y
CONFIG_LOG=y
CONFIG_BT_SMP=y
CONFIG_BT_PERIPHERAL=y
CONFIG_BT_DEVICE_NAME="quentin bluetooth"
CONFIG_BT_DEVICE_APPEARANCE=768
CONFIG_CBPRINTF_FP_SUPPORT=y
CONFIG_BT_GATT_CLIENT=y
CONFIG_BT_CENTRAL=y
CONFIG_BT_DIS=y
```

## src/main.c
```c
#include <ble_lib/ble_lib.h>
#include <button_lib/button_lib.h>
#include <led_lib/led_lib.h>
#include "service.h"
#include "gpios_init.h"

static const struct bt_data ad[] = {
	BT_DATA_BYTES(BT_DATA_FLAGS, (BT_LE_AD_GENERAL | BT_LE_AD_NO_BREDR)),
	BT_DATA_BYTES(BT_DATA_UUID16_ALL,BT_UUID_16_ENCODE(BT_UUID_UDS_VAL)),
};

struct bt_conn* connect;

static void connected(struct bt_conn *conn, uint8_t err)
{
	if (err) {
		printk("Unable to connect !\n");
		led_blink(&led0,200);
	} else {
		printk("Server connection sucess !\n");
		bt_le_adv_stop();
		connect=conn;
		led_set(&led0,HIGH);
	}
}

static void disconnected(struct bt_conn *conn, uint8_t reason)
{
	printk("Server disconnection\n");
	led_set(&led0,LOW);
}

BT_CONN_CB_DEFINE(conn_callbacks) = {
	.connected = connected,
	.disconnected = disconnected,
};

int main(void){
	button_init(&button0);
    isr_btn_config(&button0, button0_isr, &button0_cb, GPIO_INT_EDGE_BOTH);

	led_init(&led0);
	ble_enable();
	ble_advertise_start_conn(ad, ARRAY_SIZE(ad), NULL, 0);
	while(1){
		k_msleep(100); 
	}
	

	return 0;
}

void button0_isr(const struct device *dev, struct gpio_callback *cb,
		    uint32_t pins)
{
	button0_val=false;
	if(button_state(&button0)){
		button0_val=true;
	}
	ble_indicate(&button0_struct, userdata_svc, 1);
}
```

## src/service.h
```c
#ifndef SERVICE_H
#define SERVICE_H

#include<ble_lib/ble_lib.h>

bool button0_val;
struct Ble_Data button0_struct={
	.data=&button0_val,
	.size=sizeof(button0_val)
};



BT_GATT_SERVICE_DEFINE(userdata_svc,
	BT_GATT_PRIMARY_SERVICE(BT_UUID_UDS),
	BT_GATT_CHARACTERISTIC(BT_UUID_GATT_DO, BT_GATT_CHRC_INDICATE | BT_GATT_CHRC_READ | BT_GATT_CHRC_WRITE, BT_GATT_PERM_READ| BT_GATT_PERM_WRITE , read_fonction_callback, write_fonction_callback, &button0_struct),
	BT_GATT_CCC(ccc_cfg_changed, BT_GATT_PERM_READ | BT_GATT_PERM_WRITE),
	BT_GATT_CPF(NULL),
);


#endif
```
