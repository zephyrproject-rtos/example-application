## prj.conf
```kconfig
CONFIG_BT=y
CONFIG_LOG=y
CONFIG_BT_SMP=y
CONFIG_BT_PERIPHERAL=y
CONFIG_BT_DEVICE_NAME="Peripheral bluetooth"
CONFIG_BT_DEVICE_APPEARANCE=768
CONFIG_CBPRINTF_FP_SUPPORT=y
CONFIG_BT_GATT_CLIENT=y
```

## src/main.c
```c
/* main.c - Application main entry point */

/*
 * Copyright (c) 2019 Aaron Tsui <aaron.tsui@outlook.com>
 *
 * SPDX-License-Identifier: Apache-2.0
 */

#include <zephyr/types.h>
#include <stddef.h>
#include <string.h>
#include <errno.h>
#include <zephyr/sys/printk.h>
#include <zephyr/sys/byteorder.h>
#include <zephyr/kernel.h>

#include <zephyr/bluetooth/bluetooth.h>
#include <zephyr/bluetooth/hci.h>
#include <zephyr/bluetooth/conn.h>
#include <zephyr/bluetooth/uuid.h>
#include <zephyr/bluetooth/gatt.h>
#include <zephyr/bluetooth/services/bas.h>

#include "hts.h"

/*------------- Déclaration d'une structure bt_conn pour récupérer -----------
----------------------les informations de connexion ------------------------*/
static struct bt_conn *info_conn;

/*---------- Données présentes dans les données de l'advertising ----------*/
static const struct bt_data ad[] = {
	BT_DATA_BYTES(BT_DATA_FLAGS, (BT_LE_AD_GENERAL | BT_LE_AD_NO_BREDR)),
	BT_DATA_BYTES(BT_DATA_UUID16_ALL,BT_UUID_16_ENCODE(BT_UUID_UDS_VAL)),
};

/*---------- Fonctions de callback pour les évenements bluetooth ---------*/
static void connected(struct bt_conn *conn, uint8_t err)
{
	if (err) {
		printk("Connection failed (err 0x%02x)\n", err);
	} else {
		printk("Connected\n");
		/*Une fois connectés on récupère les infos de connexion*/
		info_conn = conn;
	}
}

static void disconnected(struct bt_conn *conn, uint8_t reason)
{
	printk("Disconnected (reason 0x%02x)\n", reason);
}
/*-------------------------------------------------------------------------------*/

/*----------On définit une structure de callback pour les event connected ----------
-------------- et disconnected, avec les fonctions de callback associées ---------*/
BT_CONN_CB_DEFINE(conn_callbacks) = {
	.connected = connected,
	.disconnected = disconnected,
};

/* -------------------------- Fonctions bluetooth --------------------------------*/
static void bt_ready(void)
{
	int err;

	printk("Bluetooth initialized\n");

	/*On advertise en mode connectable*/
	err = bt_le_adv_start(BT_LE_ADV_CONN_NAME, ad, ARRAY_SIZE(ad), NULL, 0);
	if (err) {
		printk("Advertising failed to start (err %d)\n", err);
		return;
	}

	printk("Advertising successfully started\n");
}

static void auth_cancel(struct bt_conn *conn)
{
	char addr[BT_ADDR_LE_STR_LEN];

	bt_addr_le_to_str(bt_conn_get_dst(conn), addr, sizeof(addr));

	printk("Pairing cancelled: %s\n", addr);
}
/* ---------------------------------------------------------------------------------*/

/* --- Définition fonction de callback pour l'évenement authentification cancel ----*/
static struct bt_conn_auth_cb auth_cb_display = {
	/*Si cancel de l'appairage, alors on exécute la fonction auth_cancel*/
	.cancel = auth_cancel,
};



int main(void)
{
	int err;

	/*Activation du bluetooth*/
	err = bt_enable(NULL);
	if (err) {
		printk("Bluetooth init failed (err %d)\n", err);
		return 0;
	}

	/*Démarrage de l'advertising*/
	bt_ready();

	/*Definition de la structure de callback liée a l'authentification*/
	bt_conn_auth_cb_register(&auth_cb_display);

	/*Envoi de la mesure en indicate*/
	while(1){
		k_sleep(K_MSEC(5000));
		/* Indication de la valeur toutes les 5 secondes*/
		valeur_indicate(info_conn);
	};

	return 0;
}
```

## src/hts.c
```c
/** @file
 *  @brief HTS Service sample
 */

/*
 * Copyright (c) 2020 SixOctets Systems
 * Copyright (c) 2019 Aaron Tsui <aaron.tsui@outlook.com>
 *
 * SPDX-License-Identifier: Apache-2.0
 */

#include <stdio.h>
#include <stddef.h>
#include <string.h>
#include <errno.h>

#include <zephyr/kernel.h>
#include <zephyr/sys/printk.h>
#include <zephyr/sys/byteorder.h>

#include <zephyr/bluetooth/bluetooth.h>
#include <zephyr/bluetooth/hci.h>
#include <zephyr/bluetooth/conn.h>
#include <zephyr/bluetooth/uuid.h>
#include <zephyr/bluetooth/gatt.h>

static uint8_t envoi;
static uint8_t indicating;

//Indicate params
static struct bt_gatt_indicate_params ind_params;

//Variable de la characteristic BT_UUID_GATT_DO du service BT_UUID_UDS
static uint8_t attr_value[] = { 10 };


/* ----- Fonction de callback de la characteristic BT_UUID_GATT_DO qui s'exécute lors d'un read d'une centrale ----- */
ssize_t read_fonction_callback(struct bt_conn *conn,
					    const struct bt_gatt_attr *attr,
					    void *buf, uint16_t len,
					    uint16_t offset)
{
	int i;
	size_t to_copy = MIN(len, sizeof(attr_value) - offset);
    if (to_copy > 0) {
        memcpy(buf, attr_value + offset, to_copy);
		printk("Valeur lue par la centrale : ");
		for (i=0; i<to_copy; i++){
			printk("%d ", ((uint8_t*)buf)[i]);
		}
		printk("\n");
        return to_copy;
    } else {
        return 0;
    }
};


/* ----- Fonction de callback de la characteristic BT_UUID_GATT_DO qui s'exécute lors d'un write d'une centrale ----- */
ssize_t write_fonction_callback(struct bt_conn *conn,
					     const struct bt_gatt_attr *attr,
					     const void *buf, uint16_t len,
					     uint16_t offset, uint8_t flags)
{
	int i;
	size_t to_copy = MIN(len, sizeof(attr_value) - offset);
    if (to_copy > 0) {
        memcpy(attr_value + offset, buf, to_copy);
		printk("Valeur écrite par la centrale : ");
		for (i=0; i<to_copy; i++){
			printk("%d ", attr_value[i]);
		}
		printk("\n");
        return to_copy;
    } else {
        return 0;
    }
};


/* --------------- Fonction qui verifie si la configuration du CCC change et l'indique ------------*/
static void ccc_cfg_changed(const struct bt_gatt_attr *attr,
				 uint16_t value)
{
	envoi = (value == BT_GATT_CCC_INDICATE) ? 1 : 0; 
	if (value == BT_GATT_CCC_INDICATE) {
        // Le client a activé les indications
        printk("Indications activées par le client\n");
    } else if (value == BT_GATT_CCC_NOTIFY) {
        // Le client a activé les notifications
        printk("Notifications activées par le client\n");
    } else {
        // Le client a désactivé les indications et les notifications
        printk("Indications et notifications désactivées par le client\n");
    }
}


/* --------------- Declaration du service qu'on utilise pour l'envoi des données ---------------*/
BT_GATT_SERVICE_DEFINE(userdata_svc,
	//Déclaration du premier service
	//L'argument est l'UUID du service à utiliser. La liste des UUID est dans uuid.h
	BT_GATT_PRIMARY_SERVICE(BT_UUID_UDS),

	//Déclaration de la caractéristique, permissions, callback etc...
	BT_GATT_CHARACTERISTIC(BT_UUID_GATT_DO, BT_GATT_CHRC_INDICATE | BT_GATT_CHRC_READ | BT_GATT_CHRC_WRITE, BT_GATT_PERM_READ | BT_GATT_PERM_WRITE , read_fonction_callback, write_fonction_callback, attr_value),

	//Client Characteristic Configuration Declaration Macro.												   
	BT_GATT_CCC(ccc_cfg_changed, BT_GATT_PERM_READ | BT_GATT_PERM_WRITE),
);


/* ------- Callback de l'indicate, s'exécute lorsque l'indicate est commencé -------------*/
static void indicate_cb(struct bt_conn *conn,
			struct bt_gatt_indicate_params *params, uint8_t err)
{
	printk("Indication %s\n", err != 0U ? "fail" : "success");
}


/* -------------Callback de l'indicate, s'exécute lorsque l'indicate est fini -----------*/
static void indicate_destroy(struct bt_gatt_indicate_params *params)
{
	//Une fois l'indicate fini on remet indicating=0 afin de pouvoir refaire un indicate.
	printk("Indication complete\n");
	indicating = 0U;
}

/* ---------------- Fonction qui se charge de l'indicate, appelée dans le main ------------------ */
void valeur_indicate(struct bt_conn *conn)
{		
	if (envoi){
		if (indicating) {
			return;
		}
		// Mise à jour des paramètres
		ind_params.attr = &userdata_svc.attrs[2];
		ind_params.func = indicate_cb;
		ind_params.destroy = indicate_destroy;
		ind_params.data = attr_value;
		ind_params.len = sizeof(attr_value);

		// On envoie la nouvelle valeur avec un indicate
		if (bt_gatt_indicate(NULL, &ind_params) == 0) {
			indicating = 1U;
		}
	}	
}
```

## src/hts.h
```c
/** @file
 *  @brief HTS Service sample
 */

/*
 * Copyright (c) 2019 Aaron Tsui <aaron.tsui@outlook.com>
 *
 * SPDX-License-Identifier: Apache-2.0
 */

#ifdef __cplusplus
extern "C" {
#endif

void valeur_indicate(struct bt_conn *conn);

#ifdef __cplusplus
}
#endif
```
