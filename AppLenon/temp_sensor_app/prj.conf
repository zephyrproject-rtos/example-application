## CMakeLists.txt
```
# Define a versão mínima do CMake e encontra o Zephyr no seu sistema
cmake_minimum_required(VERSION 3.20.0)
find_package(Zephyr REQUIRED HINTS $ENV{ZEPHYR_BASE})


project(temp_sensor_app)

# Informa ao compilador que ele também deve procurar por arquivos .h na pasta 'include'
target_include_directories(app PRIVATE include)


target_sources(app PRIVATE
	src/main.c
	src/driver_temp.c
)
```

## prj.conf
```kconfig
# --- CONFIGURAÇÕES ESSENCIAIS PARA O PROJETO ---

# Habilita a API de comunicação I2C. Necessário para a fase de hardware.
CONFIG_I2C=y

# Habilita o framework de testes Ztest. Essencial para o TDD.
# esta conflitando a main CONFIG_ZTEST=y

# Habilita o sistema de logs do Zephyr (ex: LOG_INF, LOG_ERR).
# É a forma moderna e mais poderosa de imprimir mensagens.
CONFIG_LOG=y

# Habilita a função printk(), que é uma forma mais simples de imprimir
# mensagens no console, usada no nosso main.c inicial.
CONFIG_PRINTK=y

# Habilita o driver para o sensor AT30TSE (que está na placa I/O1)
CONFIG_SENSOR_AT30TSE=y

# API dos sensores 
CONFIG_SENSOR=y
```

## src/main.c
```c
#include <zephyr/kernel.h>
#include <zephyr/device.h>       // Necessário para a API de dispositivos
#include <zephyr/drivers/sensor.h> // Necessário para a API de sensores
#include <zephyr/logging/log.h>
#include <stdio.h>               // Necessário para snprintf (para imprimir floats)

// (Opcional, mas útil) Inclui seu driver para a função de conversão,
// embora não a usemos aqui, já que a API do sensor já converte para nós.
// #include "driver_temp.h" 

LOG_MODULE_REGISTER(app_main, CONFIG_LOG_DEFAULT_LEVEL);



//    nome padrao do sensor na placa de shield I/O1 Xplained Pro
#define SENSOR_NODE DT_NODELABEL(at30tse)

// 2. Verifique se o no existe no Device Tree
#if !DT_NODE_HAS_STATUS(SENSOR_NODE, okay)
    #error "Erro: No do sensor 'at30tse' nao encontrado ou desabilitado."
#endif

// 3. Obtenha o dispositivo (struct device) a partir do no

static const struct device *sensor_dev = DEVICE_DT_GET(SENSOR_NODE);


int main(void)
{
    struct sensor_value temp_val;
    double temp_celsius;

    printk("Aplicacao do Sensor de Temperatura (Hardware Real) iniciada.\n");

    // 4. Verifica se o driver do sensor esta pronto para ser usado
    if (!device_is_ready(sensor_dev)) {
        printk("Erro: Sensor real '%s' nao esta pronto.\n", sensor_dev->name);
        return -1; // Sai se o sensor nao for encontrado
    }

    printk("Lendo do sensor real: %s\n", sensor_dev->name);

    while (1) {
        // 5. Busca uma nova "leitura" do sensor
        //    (Isso ira se comunicar via I2C com o chip AT30TSE)
        if (sensor_sample_fetch(sensor_dev) != 0) {
            printk("Erro: Falha ao buscar leitura do sensor real (I2C?).\n");
            k_sleep(K_SECONDS(10));
            continue;
        }

        // 6. Pega o canal de "Temperatura Ambiente" do sensor
        if (sensor_channel_get(sensor_dev, SENSOR_CHAN_AMBIENT_TEMP, &temp_val) != 0) {
            printk("Erro: Falha ao ler o canal de temperatura do sensor.\n");
            k_sleep(K_SECONDS(10));
            continue;
        }

        // 7. Converte o valor do sensor (struct) para um double (float)
        //    (O driver do AT30TSE faz a conversao para Celsius automaticamente)
        temp_celsius = sensor_value_to_double(&temp_val);

        // 8. Imprime o valor!
        //    Usamos snprintf porque o printk padrao do Zephyr nao
        //    lida com floats (%f) a menos que habilitado (o que gasta muita memoria).
        char buffer[32];
        snprintf(buffer, sizeof(buffer), "%.2f", temp_celsius);
        printk("Temperatura ATUAL: %s C\n", buffer);


        // Aguarda 10 segundos antes de ler novamente
        k_sleep(K_SECONDS(10));
    }
    return 0;
}
```
