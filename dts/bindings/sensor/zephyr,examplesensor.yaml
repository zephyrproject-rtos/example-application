## samples/demo_multilink_btn_led/demo_multilink_led_periph/build/Kconfig/Kconfig.modules
```kconfig
menu "pfe (/home/jordan/Documents/PFE_2/pfe)"
osource "/home/jordan/Documents/PFE_2/pfe/Kconfig.pfe"
config ZEPHYR_PFE_MODULE
	bool
	default y
endmenu
menu "cmsis (/home/jordan/Documents/PFE_2/modules/hal/cmsis)"
osource "$(ZEPHYR_CMSIS_KCONFIG)"
config ZEPHYR_CMSIS_MODULE
	bool
	default y
endmenu
menu "hal_nordic (/home/jordan/Documents/PFE_2/modules/hal/nordic)"
osource "$(ZEPHYR_HAL_NORDIC_KCONFIG)"
config ZEPHYR_HAL_NORDIC_MODULE
	bool
	default y
endmenu
config ZEPHYR_STM32_MODULE
   bool
   default y
config ZEPHYR_LIBMETAL_MODULE
   bool
   default y
menu "liblc3 (/home/jordan/Documents/PFE_2/modules/lib/liblc3)"
osource "$(ZEPHYR_LIBLC3_KCONFIG)"
config ZEPHYR_LIBLC3_MODULE
	bool
	default y
endmenu
config ZEPHYR_MCUBOOT_MODULE
   bool
   default y
config ZEPHYR_OPEN_AMP_MODULE
   bool
   default y
menu "picolibc (/home/jordan/Documents/PFE_2/modules/lib/picolibc)"
osource "/home/jordan/Documents/PFE_2/modules/lib/picolibc/zephyr/Kconfig"
config ZEPHYR_PICOLIBC_MODULE
	bool
	default y
endmenu
config ZEPHYR_TINYCRYPT_MODULE
   bool
   default y
menu "uoscore-uedhoc (/home/jordan/Documents/PFE_2/modules/lib/uoscore-uedhoc)"
osource "$(ZEPHYR_UOSCORE_UEDHOC_KCONFIG)"
config ZEPHYR_UOSCORE_UEDHOC_MODULE
	bool
	default y
endmenu
menu "zcbor (/home/jordan/Documents/PFE_2/modules/lib/zcbor)"
osource "$(ZEPHYR_ZCBOR_KCONFIG)"
config ZEPHYR_ZCBOR_MODULE
	bool
	default y
endmenu
```

## samples/peripheral_userdata_continuously/build/Kconfig/Kconfig.shield
```kconfig
osource "/home/openphung/Documents/workspace/pfe.git/boards/shields/*/Kconfig.shield"
```

## services/Kconfig
```kconfig
# GATT Services

# Copyright (c) 2018 Nordic Semiconductor ASA
# SPDX-License-Identifier: Apache-2.0

menu "GATT Services"
	depends on BT_CONN


rsource "Kconfig.led"


endmenu
```

## services/Kconfig.led
```kconfig
# Bluetooth GATT Led service

# Copyright (c) 2018 Nordic Semiconductor ASA
# SPDX-License-Identifier: Apache-2.0

config BT_TEST
	bool "GATT Led service"
```

## subsys/Kconfig
```kconfig
# Copyright (c) 2021 Legrand North America, LLC.
# SPDX-License-Identifier: Apache-2.0

# Subsystem configuration options

menu "Subsystems"

rsource "custom_subsys/Kconfig"

endmenu
```

## subsys/custom_subsys/Kconfig
```kconfig
# Copyright (c) 2020 Legrand North America, LLC.
#
# SPDX-License-Identifier: Apache-2.0

config CUSTOM_SUBSYS
    bool "Custom Subsys"
    select LOG
    help
      This option enables Custom Subsys service

if CUSTOM_SUBSYS

module = CUSTOM_SUBSYS
module-str = Log level for Custom Subsys
source "subsys/logging/Kconfig.template.log_config"

endif # CUSTOM_SUBSYS
```

## subsys/module_hello/Kconfig
```kconfig
# Copyright (c) 2020 Legrand North America, LLC.
# SPDX-License-Identifier: Apache-2.0

config MODULE_HELLO
    bool "Module \"Hello\""
    select LOG
    help
      This option enables Module Hello service

if MODULE_HELLO

module = MODULE_HELLO
module-str = Log level for Module Hello
source "subsys/logging/Kconfig.template.log_config"

endif # MODULE_HELLO
```

## tests/lib/custom_lib/testcase.yaml
```yaml
common:
  tags: extensibility
  integration_platforms:
    - custom_plank
    - qemu_cortex_m0
tests:
  lib.custom_lib: {}
  lib.custom_lib.non_default:
    extra_args: CONFIG_CUSTOM_LIB_GET_VALUE_DEFAULT=6
```
