## dts/bindings/sensor/zephyr,examplesensor.yaml
```yaml
# Copyright (c) 2021 Nordic Semiconductor ASA
# SPDX-License-Identifier: Apache-2.0

description: |
  An example sensor that reads the GPIO level defined in input-gpios. The
  purpose of this sensor is to demonstrate how to create out-of-tree drivers.

  Example definition in devicetree:

    examplesensor {
        compatible = "zephyr,examplesensor";
        label = "EXAMPLESENSOR";
        input-gpios = <&gpio0 0 (GPIO_PULL_UP | GPIO_ACTIVE_LOW)>;
    };

compatible: "zephyr,examplesensor"

include: base.yaml

properties:
  input-gpios:
    type: phandle-array
    required: true
    description: Input GPIO to be sensed.
```

## lib/Kconfig
```kconfig
# Copyright (c) 2021 Legrand North America, LLC.
# SPDX-License-Identifier: Apache-2.0

menu "Custom libraries"

rsource "custom/Kconfig"

endmenu
```

## lib/ble_lib/Kconfig
```kconfig
# Copyright (c) 2021, Legrand North America, LLC.
# SPDX-License-Identifier: Apache-2.0

config BLE_LIB
	bool "ble_lib Support"
	help
	  This option enables the ble_lib library
```

## lib/button_lib/Kconfig
```kconfig
# Copyright (c) 2021, Legrand North America, LLC.
# SPDX-License-Identifier: Apache-2.0

config BUTTON_LIB
	bool "button_lib Support"
	help
	  This option enables the button_lib library
```

## lib/custom/Kconfig
```kconfig
# Copyright (c) 2021, Legrand North America, LLC.
# SPDX-License-Identifier: Apache-2.0

config CUSTOM
	bool "Support for custom library"
	help
	  This option enables the 'custom' library

config CUSTOM_GET_VALUE_DEFAULT
	int "custom_get_value() default return value"
	depends on CUSTOM
	default 0
	help
	  This option primarily exists as an example of a library Kconfig
	  setting.

	  This option specifies the value for custom_get_value() to return
	  when the input parameter is zero. (Otherwise the function returns the
	  input parameter value.)
```

## lib/custom_lib/Kconfig
```kconfig
# Copyright (c) 2021, Legrand North America, LLC.
# SPDX-License-Identifier: Apache-2.0

config CUSTOM_LIB
	bool "custom_lib Support"
	help
	  This option enables the custom_lib library

config CUSTOM_LIB_GET_VALUE_DEFAULT
	int "custom_lib_get_value() default return value"
	depends on CUSTOM_LIB
	default 0
	help
	  This option primarily exists as an example of a library Kconfig
	  setting.

	  This option specifies the value for custom_lib_get_value()
	  to return when the input parameter is zero.  (Otherwise
	  the function returns the input parameter value.)
```

## lib/led_lib/Kconfig
```kconfig
# Copyright (c) 2021, Legrand North America, LLC.
# SPDX-License-Identifier: Apache-2.0

config LED_LIB
	bool "led_lib Support"
	help
	  This option enables the custom_lib library
```

## novaapp/build/Kconfig/Kconfig.sysbuild.modules
```kconfig
config ZEPHYR_ZEPHYR_APP_UFSM00292_GIT_MODULE
   bool
   default y
config ZEPHYR_CMSIS_6_MODULE
   bool
   default y
config ZEPHYR_HAL_NORDIC_MODULE
   bool
   default y
config ZEPHYR_HAL_STM32_MODULE
   bool
   default y
```

## novaapp/build/Kconfig/arch/Kconfig
```kconfig
# Load Zephyr Arch Kconfig descriptions.
osource "C:/Users/Jaque/my-workspace/zephyr/arch/rx/Kconfig"
osource "C:/Users/Jaque/my-workspace/zephyr/arch/x86/Kconfig"
osource "C:/Users/Jaque/my-workspace/zephyr/arch/xtensa/Kconfig"
osource "C:/Users/Jaque/my-workspace/zephyr/arch/sparc/Kconfig"
osource "C:/Users/Jaque/my-workspace/zephyr/arch/riscv/Kconfig"
osource "C:/Users/Jaque/my-workspace/zephyr/arch/posix/Kconfig"
osource "C:/Users/Jaque/my-workspace/zephyr/arch/mips/Kconfig"
osource "C:/Users/Jaque/my-workspace/zephyr/arch/arm64/Kconfig"
osource "C:/Users/Jaque/my-workspace/zephyr/arch/arm/Kconfig"
osource "C:/Users/Jaque/my-workspace/zephyr/arch/arc/Kconfig"
```

## novaapp/build/Kconfig/boards/Kconfig.nucleo_l476rg
```kconfig
# Load board Kconfig descriptions.
osource "C:/Users/Jaque/my-workspace/zephyr/boards/st/nucleo_l476rg/Kconfig.nucleo_l476rg"
```

## novaapp/build/Kconfig/boards/Kconfig.sysbuild
```kconfig
# Load Sysbuild board Kconfig descriptions.
osource "C:/Users/Jaque/my-workspace/zephyr/boards/st/nucleo_l476rg/Kconfig.sysbuild"
```

## novaapp/build/Kconfig/soc/Kconfig.sysbuild
```kconfig
# Load Sysbuild SoC Kconfig descriptions.
osource "C:/Users/Jaque/my-workspace/zephyr/soc/xlnx/zynqmp/Kconfig.sysbuild"
osource "C:/Users/Jaque/my-workspace/zephyr/soc/xlnx/zynq7000/Kconfig.sysbuild"
osource "C:/Users/Jaque/my-workspace/zephyr/soc/xlnx/versalnet/Kconfig.sysbuild"
osource "C:/Users/Jaque/my-workspace/zephyr/soc/xlnx/versal2/Kconfig.sysbuild"
osource "C:/Users/Jaque/my-workspace/zephyr/soc/xen/Kconfig.sysbuild"
osource "C:/Users/Jaque/my-workspace/zephyr/soc/wch/ch32v/Kconfig.sysbuild"
osource "C:/Users/Jaque/my-workspace/zephyr/soc/ti/simplelink/Kconfig.sysbuild"
osource "C:/Users/Jaque/my-workspace/zephyr/soc/ti/mspm0/Kconfig.sysbuild"
osource "C:/Users/Jaque/my-workspace/zephyr/soc/ti/lm3s6965/Kconfig.sysbuild"
osource "C:/Users/Jaque/my-workspace/zephyr/soc/ti/k3/Kconfig.sysbuild"
osource "C:/Users/Jaque/my-workspace/zephyr/soc/telink/tlsr/Kconfig.sysbuild"
osource "C:/Users/Jaque/my-workspace/zephyr/soc/starfive/jh71xx/Kconfig.sysbuild"
osource "C:/Users/Jaque/my-workspace/zephyr/soc/st/stm32/Kconfig.sysbuild"
osource "C:/Users/Jaque/my-workspace/zephyr/soc/snps/qemu_arc/Kconfig.sysbuild"
osource "C:/Users/Jaque/my-workspace/zephyr/soc/snps/nsim/arc_v/Kconfig.sysbuild"
osource "C:/Users/Jaque/my-workspace/zephyr/soc/snps/nsim/arc_classic/Kconfig.sysbuild"
osource "C:/Users/Jaque/my-workspace/zephyr/soc/snps/hsdk4xd/Kconfig.sysbuild"
osource "C:/Users/Jaque/my-workspace/zephyr/soc/snps/hsdk/Kconfig.sysbuild"
osource "C:/Users/Jaque/my-workspace/zephyr/soc/snps/emsk/Kconfig.sysbuild"
osource "C:/Users/Jaque/my-workspace/zephyr/soc/snps/emsdp/Kconfig.sysbuild"
osource "C:/Users/Jaque/my-workspace/zephyr/soc/snps/arc_iot/Kconfig.sysbuild"
osource "C:/Users/Jaque/my-workspace/zephyr/soc/silabs/Kconfig.sysbuild"
osource "C:/Users/Jaque/my-workspace/zephyr/soc/sifli/sf32/Kconfig.sysbuild"
osource "C:/Users/Jaque/my-workspace/zephyr/soc/sifive/sifive_freedom/Kconfig.sysbuild"
osource "C:/Users/Jaque/my-workspace/zephyr/soc/sensry/Kconfig.sysbuild"
osource "C:/Users/Jaque/my-workspace/zephyr/soc/rockchip/Kconfig.sysbuild"
osource "C:/Users/Jaque/my-workspace/zephyr/soc/renode/riscv_virtual/Kconfig.sysbuild"
osource "C:/Users/Jaque/my-workspace/zephyr/soc/renode/cortex_r8_virtual/Kconfig.sysbuild"
osource "C:/Users/Jaque/my-workspace/zephyr/soc/renesas/smartbond/Kconfig.sysbuild"
osource "C:/Users/Jaque/my-workspace/zephyr/soc/renesas/rz/Kconfig.sysbuild"
osource "C:/Users/Jaque/my-workspace/zephyr/soc/renesas/rx/Kconfig.sysbuild"
osource "C:/Users/Jaque/my-workspace/zephyr/soc/renesas/rcar/Kconfig.sysbuild"
osource "C:/Users/Jaque/my-workspace/zephyr/soc/renesas/ra/Kconfig.sysbuild"
osource "C:/Users/Jaque/my-workspace/zephyr/soc/realtek/ec/Kconfig.sysbuild"
osource "C:/Users/Jaque/my-workspace/zephyr/soc/raspberrypi/rpi_pico/Kconfig.sysbuild"
osource "C:/Users/Jaque/my-workspace/zephyr/soc/quicklogic/eos_s3/Kconfig.sysbuild"
osource "C:/Users/Jaque/my-workspace/zephyr/soc/qemu/virt_riscv/Kconfig.sysbuild"
osource "C:/Users/Jaque/my-workspace/zephyr/soc/qemu/malta/Kconfig.sysbuild"
osource "C:/Users/Jaque/my-workspace/zephyr/soc/openisa/rv32m1/Kconfig.sysbuild"
osource "C:/Users/Jaque/my-workspace/zephyr/soc/openhwgroup/cva6/Kconfig.sysbuild"
osource "C:/Users/Jaque/my-workspace/zephyr/soc/oct/osd32mp15x/Kconfig.sysbuild"
osource "C:/Users/Jaque/my-workspace/zephyr/soc/nxp/s32/Kconfig.sysbuild"
osource "C:/Users/Jaque/my-workspace/zephyr/soc/nxp/rw/Kconfig.sysbuild"
osource "C:/Users/Jaque/my-workspace/zephyr/soc/nxp/mcx/Kconfig.sysbuild"
osource "C:/Users/Jaque/my-workspace/zephyr/soc/nxp/lpc/Kconfig.sysbuild"
osource "C:/Users/Jaque/my-workspace/zephyr/soc/nxp/layerscape/Kconfig.sysbuild"
osource "C:/Users/Jaque/my-workspace/zephyr/soc/nxp/kinetis/Kconfig.sysbuild"
osource "C:/Users/Jaque/my-workspace/zephyr/soc/nxp/imxrt/Kconfig.sysbuild"
osource "C:/Users/Jaque/my-workspace/zephyr/soc/nxp/imx/Kconfig.sysbuild"
osource "C:/Users/Jaque/my-workspace/zephyr/soc/nuvoton/numicro/Kconfig.sysbuild"
osource "C:/Users/Jaque/my-workspace/zephyr/soc/nuvoton/numaker/Kconfig.sysbuild"
osource "C:/Users/Jaque/my-workspace/zephyr/soc/nuvoton/npcx/Kconfig.sysbuild"
osource "C:/Users/Jaque/my-workspace/zephyr/soc/nuvoton/npcm/Kconfig.sysbuild"
osource "C:/Users/Jaque/my-workspace/zephyr/soc/nordic/Kconfig.sysbuild"
osource "C:/Users/Jaque/my-workspace/zephyr/soc/neorv32/Kconfig.sysbuild"
osource "C:/Users/Jaque/my-workspace/zephyr/soc/native/inf_clock/Kconfig.sysbuild"
osource "C:/Users/Jaque/my-workspace/zephyr/soc/microchip/sam/Kconfig.sysbuild"
osource "C:/Users/Jaque/my-workspace/zephyr/soc/microchip/sam/sam_d5x_e5x/Kconfig.sysbuild"
osource "C:/Users/Jaque/my-workspace/zephyr/soc/microchip/pic32c/pic32cm_jh/Kconfig.sysbuild"
osource "C:/Users/Jaque/my-workspace/zephyr/soc/microchip/miv/Kconfig.sysbuild"
osource "C:/Users/Jaque/my-workspace/zephyr/soc/microchip/mec/Kconfig.sysbuild"
osource "C:/Users/Jaque/my-workspace/zephyr/soc/mediatek/mt8xxx/Kconfig.sysbuild"
osource "C:/Users/Jaque/my-workspace/zephyr/soc/lowrisc/opentitan/Kconfig.sysbuild"
osource "C:/Users/Jaque/my-workspace/zephyr/soc/litex/litex_vexriscv/Kconfig.sysbuild"
osource "C:/Users/Jaque/my-workspace/zephyr/soc/ite/ec/Kconfig.sysbuild"
osource "C:/Users/Jaque/my-workspace/zephyr/soc/intel/raptor_lake/Kconfig.sysbuild"
osource "C:/Users/Jaque/my-workspace/zephyr/soc/intel/panther_lake/Kconfig.sysbuild"
osource "C:/Users/Jaque/my-workspace/zephyr/soc/intel/lakemont/Kconfig.sysbuild"
osource "C:/Users/Jaque/my-workspace/zephyr/soc/intel/intel_socfpga_std/Kconfig.sysbuild"
osource "C:/Users/Jaque/my-workspace/zephyr/soc/intel/intel_socfpga/Kconfig.sysbuild"
osource "C:/Users/Jaque/my-workspace/zephyr/soc/intel/intel_niosv/Kconfig.sysbuild"
osource "C:/Users/Jaque/my-workspace/zephyr/soc/intel/intel_ish/Kconfig.sysbuild"
osource "C:/Users/Jaque/my-workspace/zephyr/soc/intel/intel_adsp/Kconfig.sysbuild"
osource "C:/Users/Jaque/my-workspace/zephyr/soc/intel/elkhart_lake/Kconfig.sysbuild"
osource "C:/Users/Jaque/my-workspace/zephyr/soc/intel/atom/Kconfig.sysbuild"
osource "C:/Users/Jaque/my-workspace/zephyr/soc/intel/apollo_lake/Kconfig.sysbuild"
osource "C:/Users/Jaque/my-workspace/zephyr/soc/intel/alder_lake/Kconfig.sysbuild"
osource "C:/Users/Jaque/my-workspace/zephyr/soc/infineon/cat3/Kconfig.sysbuild"
osource "C:/Users/Jaque/my-workspace/zephyr/soc/infineon/cat1c/Kconfig.sysbuild"
osource "C:/Users/Jaque/my-workspace/zephyr/soc/infineon/cat1b/Kconfig.sysbuild"
osource "C:/Users/Jaque/my-workspace/zephyr/soc/infineon/cat1a/Kconfig.sysbuild"
osource "C:/Users/Jaque/my-workspace/zephyr/soc/gd/gd32/Kconfig.sysbuild"
osource "C:/Users/Jaque/my-workspace/zephyr/soc/gaisler/leon3/Kconfig.sysbuild"
osource "C:/Users/Jaque/my-workspace/zephyr/soc/gaisler/gr716a/Kconfig.sysbuild"
osource "C:/Users/Jaque/my-workspace/zephyr/soc/espressif/Kconfig.sysbuild"
osource "C:/Users/Jaque/my-workspace/zephyr/soc/ene/kb1200/Kconfig.sysbuild"
osource "C:/Users/Jaque/my-workspace/zephyr/soc/ene/kb106x/Kconfig.sysbuild"
osource "C:/Users/Jaque/my-workspace/zephyr/soc/efinix/sapphire/Kconfig.sysbuild"
osource "C:/Users/Jaque/my-workspace/zephyr/soc/cdns/xtensa_sample_controller/Kconfig.sysbuild"
osource "C:/Users/Jaque/my-workspace/zephyr/soc/cdns/sample_controller32/Kconfig.sysbuild"
osource "C:/Users/Jaque/my-workspace/zephyr/soc/cdns/dc233c/Kconfig.sysbuild"
osource "C:/Users/Jaque/my-workspace/zephyr/soc/brcm/bcmvk/Kconfig.sysbuild"
osource "C:/Users/Jaque/my-workspace/zephyr/soc/brcm/bcm2712/Kconfig.sysbuild"
osource "C:/Users/Jaque/my-workspace/zephyr/soc/brcm/bcm2711/Kconfig.sysbuild"
osource "C:/Users/Jaque/my-workspace/zephyr/soc/bflb/Kconfig.sysbuild"
osource "C:/Users/Jaque/my-workspace/zephyr/soc/atmel/sam0/Kconfig.sysbuild"
osource "C:/Users/Jaque/my-workspace/zephyr/soc/atmel/sam/Kconfig.sysbuild"
osource "C:/Users/Jaque/my-workspace/zephyr/soc/aspeed/Kconfig.sysbuild"
osource "C:/Users/Jaque/my-workspace/zephyr/soc/arm/Kconfig.sysbuild"
osource "C:/Users/Jaque/my-workspace/zephyr/soc/arm/beetle/Kconfig.sysbuild"
osource "C:/Users/Jaque/my-workspace/zephyr/soc/antmicro/myra/Kconfig.sysbuild"
osource "C:/Users/Jaque/my-workspace/zephyr/soc/andestech/Kconfig.sysbuild"
osource "C:/Users/Jaque/my-workspace/zephyr/soc/amd/acp_6_0/Kconfig.sysbuild"
osource "C:/Users/Jaque/my-workspace/zephyr/soc/ambiq/Kconfig.sysbuild"
osource "C:/Users/Jaque/my-workspace/zephyr/soc/aesc/Kconfig.sysbuild"
osource "C:/Users/Jaque/my-workspace/zephyr/soc/adi/max32/Kconfig.sysbuild"
```

## projeto-final/dts/bindings/sensor/microchip,at30tse752a.yaml
```yaml
# Device tree binding para sensor AT30TSE752A

description: Microchip AT30TSE752A Temperature Sensor

compatible: "microchip,at30tse752a"

include: i2c-device.yaml

properties:
  reg:
    required: true
    description: I2C address of the sensor

  resolution:
    type: int
    required: false
    description: |
      Sensor resolution in bits (9, 10, 11, or 12)
    default: 12
```

## samples/button_led/build/Kconfig/Kconfig.modules
```kconfig
menu "pfe (/home/openphung/Documents/workspace/pfe.git)"
osource "/home/openphung/Documents/workspace/pfe.git/Kconfig.pfe"
config ZEPHYR_PFE_MODULE
	bool
	default y
endmenu
menu "cmsis (/home/openphung/Documents/workspace/modules/hal/cmsis)"
osource "$(ZEPHYR_CMSIS_KCONFIG)"
config ZEPHYR_CMSIS_MODULE
	bool
	default y
endmenu
menu "hal_nordic (/home/openphung/Documents/workspace/modules/hal/nordic)"
osource "$(ZEPHYR_HAL_NORDIC_KCONFIG)"
config ZEPHYR_HAL_NORDIC_MODULE
	bool
	default y
endmenu
config ZEPHYR_STM32_MODULE
   bool
   default y
config ZEPHYR_LIBMETAL_MODULE
   bool
   default y
menu "liblc3 (/home/openphung/Documents/workspace/modules/lib/liblc3)"
osource "$(ZEPHYR_LIBLC3_KCONFIG)"
config ZEPHYR_LIBLC3_MODULE
	bool
	default y
endmenu
config ZEPHYR_MCUBOOT_MODULE
   bool
   default y
config ZEPHYR_OPEN_AMP_MODULE
   bool
   default y
menu "picolibc (/home/openphung/Documents/workspace/modules/lib/picolibc)"
osource "/home/openphung/Documents/workspace/modules/lib/picolibc/zephyr/Kconfig"
config ZEPHYR_PICOLIBC_MODULE
	bool
	default y
endmenu
config ZEPHYR_TINYCRYPT_MODULE
   bool
   default y
menu "uoscore-uedhoc (/home/openphung/Documents/workspace/modules/lib/uoscore-uedhoc)"
osource "$(ZEPHYR_UOSCORE_UEDHOC_KCONFIG)"
config ZEPHYR_UOSCORE_UEDHOC_MODULE
	bool
	default y
endmenu
menu "zcbor (/home/openphung/Documents/workspace/modules/lib/zcbor)"
osource "$(ZEPHYR_ZCBOR_KCONFIG)"
config ZEPHYR_ZCBOR_MODULE
	bool
	default y
endmenu
```

## samples/button_led/build/Kconfig/Kconfig.shield.defconfig
```kconfig
osource "/home/quentin/Documents/workspace/pfe.git/boards/shields/*/Kconfig.defconfig"
```
