## CMakeLists.txt
```
# Copyright (c) 2025 James Walmsley <james@fullfat-fs.co.uk>
# SPDX-License-Identifier: Apache-2.0

cmake_minimum_required(VERSION 3.20.0)
find_package(Zephyr REQUIRED HINTS $ENV{ZPEHYR_BASE})

project(mfg_image)
target_sources(app PRIVATE src/main.c)
```

## prj.conf
```kconfig
CONFIG_BOOTLOADER_MCUBOOT=y
CONFIG_MCUBOOT_SIGNATURE_KEY_FILE="bootloader/mcuboot/root-rsa-2048.pem"
```

## src/main.c
```c
/*
 * Copyright (c) 2025 James Walmsley
 * SPDX-License-Identifier: Apache-2.0
 */

#include <zephyr/sys/printk.h>

int main(void)
{
	printk("Manufacturing image on: %s\n", CONFIG_BOARD_TARGET);

	return 0;
}
```
