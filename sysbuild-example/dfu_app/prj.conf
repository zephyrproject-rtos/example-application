## CMakeLists.txt
```
# Copyright (c) 2025 James Walmsley <james@fullfat-fs.co.uk>
# SPDX-License-Identifier: Apache-2.0

cmake_minimum_required(VERSION 3.20.0)
find_package(Zephyr REQUIRED HINTS $ENV{ZEPHYR_BASE})

project(dfu_app)
target_sources(app PRIVATE src/main.c)
```

## prj.conf
```kconfig
CONFIG_BOOTLOADER_MCUBOOT=y
CONFIG_MCUBOOT_SIGNATURE_KEY_FILE="bootloader/mcuboot/root-rsa-2048.pem"
CONFIG_FLASH=y
CONFIG_IMG_MANAGER=y
CONFIG_STREAM_FLASH=y
CONFIG_USB_DFU_CLASS=y
CONFIG_USB_DEVICE_STACK=y
CONFIG_FLASH_MAP=y
```

## boards/nucleo_f413zh.overlay
```dts
/ {
	chosen {
		zephyr,code-partition = &app_partition;
	};
};
```

## src/main.c
```c
/*
 * Copyright (c) 2025 James Walmsley
 * SPDX-License-Identifier: Apache-2.0
 */

#include <zephyr/sys/printk.h>

int main(void)
{
	printk("Hello world from 2 %s\n", CONFIG_BOARD_TARGET);

	return 0;
}
```
