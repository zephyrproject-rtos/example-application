## demo/central_peripheral_indicate_read_write/peripheral_indicate_read_write/build/Kconfig/Kconfig.sysbuild.modules
```kconfig
menu "nrf (/home/jordan/ncs/v2.5.1/nrf)"
osource "/home/jordan/ncs/v2.5.1/nrf/sysbuild/Kconfig.sysbuild"
config ZEPHYR_NRF_MODULE
	bool
	default y
endmenu
```

## drivers/Kconfig
```kconfig
# Copyright (c) 2021 Nordic Semiconductor ASA
# SPDX-License-Identifier: Apache-2.0

menu "Drivers"
rsource "blink/Kconfig"
rsource "sensor/Kconfig"
endmenu
```

## drivers/blink/Kconfig
```kconfig
# Copyright (c) 2024 Nordic Semiconductor ASA
# SPDX-License-Identifier: Apache-2.0

menuconfig BLINK
	bool "Blink device drivers"
	help
	  This option enables the blink custom driver class.

if BLINK

config BLINK_INIT_PRIORITY
	int "Blink device drivers init priority"
	default KERNEL_INIT_PRIORITY_DEVICE
	help
	  Blink device drivers init priority.

module = BLINK
module-str = blink
source "subsys/logging/Kconfig.template.log_config"

rsource "Kconfig.gpio_led"

endif # BLINK
```

## drivers/blink/Kconfig.gpio_led
```kconfig
# Copyright (c) 2024 Nordic Semiconductor ASA
# SPDX-License-Identifier: Apache-2.0

config BLINK_GPIO_LED
	bool "GPIO-controlled LED blink driver"
	default y
	depends on DT_HAS_BLINK_GPIO_LED_ENABLED
	select GPIO
	help
	  Enable this option to use the GPIO-controlled LED blink driver. This
	  demonstrates how to implement a driver for a custom driver class.
```

## drivers/ethernet/Kconfig.ksz8851snl
```kconfig
# ETH_KSZ8851SNL Ethernet driver configuration options

# Copyright (c) 2024 Zephyr Project
# SPDX-License-Identifier: Apache-2.0

menuconfig ETH_KSZ8851SNL
	bool "KSZ8851SNL Ethernet Controller"
	default y
	depends on DT_HAS_MICROCHIP_KSZ8851SNL_ENABLED
	select SPI
	help
	  KSZ8851SNL Stand-Alone Ethernet Controller
	  with SPI Interface

if ETH_KSZ8851SNL

config ETH_KSZ8851SNL_RX_THREAD_STACK_SIZE
	int "Stack size for internal incoming packet handler"
	depends on ETH_KSZ8851SNL
	default 800
	help
	  Size of the stack used for internal thread which is ran for
	  incoming packet processing.

config ETH_KSZ8851SNL_RX_THREAD_PRIO
	int "Priority for internal incoming packet handler"
	depends on ETH_KSZ8851SNL
	default 2
	help
	  Priority level for internal thread which is ran for incoming
	  packet processing.

config ETH_KSZ8851SNL_TIMEOUT
	int "IP buffer timeout"
	depends on ETH_KSZ8851SNL
	default 100
	help
	  Given timeout in milliseconds. Maximum amount of time
	  that the driver will wait from the IP stack to get
	  a memory buffer before the Ethernet frame is dropped.

endif # ETH_KSZ8851SNL
```

## drivers/sensor/Kconfig
```kconfig
# Copyright (c) 2021 Nordic Semiconductor ASA
# SPDX-License-Identifier: Apache-2.0

if SENSOR
rsource "example_sensor/Kconfig"
endif # SENSOR
```

## drivers/sensor/example_sensor/Kconfig
```kconfig
# Copyright (c) 2021 Nordic Semiconductor ASA
# SPDX-License-Identifier: Apache-2.0

config EXAMPLE_SENSOR
	bool "Example sensor"
	default y
	depends on DT_HAS_ZEPHYR_EXAMPLE_SENSOR_ENABLED
	select GPIO
	help
	  Enable example sensor

config MY_TIMER_INITIAL_DELAY
    int "Initial delay for my timer (in seconds)"
    default 100
    help
      Configura el retraso inicial para el temporizador en segundos.

config MY_TIMER_PERIOD
    int "Period for my timer (in seconds)"
    default 10
    help
      Configura el período para el temporizador en segundos.

config PATH_TO_CSV_FILE
	string "Path to the CSV file"
	default "/home/nbergall/Desktop/data.csv"
	help
	  Configura la ruta al archivo CSV.

config SIZE_LINE_MAX
	int "Max size of a line in the CSV file"
	default 10
	help
	  Configura el tamaño máximo de una línea en el archivo CSV.
```

## drivers/sensor/examplesensor/Kconfig
```kconfig
# Copyright (c) 2021 Nordic Semiconductor ASA
# SPDX-License-Identifier: Apache-2.0

config EXAMPLESENSOR
	bool "Example sensor"
	default y
	depends on DT_HAS_ZEPHYR_EXAMPLESENSOR_ENABLED
	select GPIO
	help
	  Enable example sensor
```

## dts/bindings/blink/blink-gpio-leds.yaml
```yaml
# Copyright (c) 2024 Nordic Semiconductor ASA
# SPDX-License-Identifier: Apache-2.0

description: |
  A generic binding for a GPIO-controlled blinking LED. Note that this binding
  has no vendor prefix, as it does not target a specific device or vendor.

  Example definition in devicetree:

    blink-gpio-led {
        compatible = "blink-gpio-led";
        led-gpios = <&gpio0 0 GPIO_ACTIVE_HIGH>;
        blink-period-ms = <1000>;
    };

compatible: "blink-gpio-led"

include: base.yaml

properties:
  led-gpios:
    type: phandle-array
    required: true
    description: GPIO-controlled LED.

  blink-period-ms:
    type: int
    description: Initial blinking period in milliseconds.
```

## dts/bindings/ethernet/microchip,ksz8851snl.yaml
```yaml
# Copyright (c) 2024 Zephyr Project
# SPDX-License-Identifier: Apache-2.0

description: KSZ8851SNL standalone 10/100BASE-T Ethernet controller with SPI interface

compatible: "microchip,ksz8851snl"

include: [spi-device.yaml, ethernet-controller.yaml]

properties:
  int-gpios:
    type: phandle-array
    required: true
    description: Interrupt pin.

      The interrupt pin of KSZ8851SNL is active low.
      If connected directly the MCU pin should be configured
      as active low.

  reset-gpios:
    type: phandle-array
    description: Reset pin.

      The reset pin of KSZ8851SNL is active low.
      If connected directly the MCU pin should be configured
      as active low.

  full-duplex:
    type: boolean
    description: |
      Optional feature flag - Enables full duplex operation.
      If not specified, the driver will auto-negotiate.
```

## dts/bindings/sensor/zephyr,example-sensor.yaml
```yaml
# Copyright (c) 2021 Nordic Semiconductor ASA
# SPDX-License-Identifier: Apache-2.0

description: |
  This binding is used to describe the example sensor driver.

compatible: "zephyr,example-sensor"

include: base.yaml
```
