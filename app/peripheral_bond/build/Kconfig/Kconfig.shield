## apps/novaapp/build/Kconfig/soc/Kconfig.defconfig
```kconfig
# Load Zephyr SoC defconfig descriptions.
osource "C:/Users/Jaque/my-workspace/zephyr/soc/xlnx/zynqmp/Kconfig.defconfig"
osource "C:/Users/Jaque/my-workspace/zephyr/soc/xlnx/zynq7000/Kconfig.defconfig"
osource "C:/Users/Jaque/my-workspace/zephyr/soc/xlnx/versalnet/Kconfig.defconfig"
osource "C:/Users/Jaque/my-workspace/zephyr/soc/xlnx/versal2/Kconfig.defconfig"
osource "C:/Users/Jaque/my-workspace/zephyr/soc/xen/Kconfig.defconfig"
osource "C:/Users/Jaque/my-workspace/zephyr/soc/wch/ch32v/Kconfig.defconfig"
osource "C:/Users/Jaque/my-workspace/zephyr/soc/ti/simplelink/Kconfig.defconfig"
osource "C:/Users/Jaque/my-workspace/zephyr/soc/ti/mspm0/Kconfig.defconfig"
osource "C:/Users/Jaque/my-workspace/zephyr/soc/ti/lm3s6965/Kconfig.defconfig"
osource "C:/Users/Jaque/my-workspace/zephyr/soc/ti/k3/Kconfig.defconfig"
osource "C:/Users/Jaque/my-workspace/zephyr/soc/telink/tlsr/Kconfig.defconfig"
osource "C:/Users/Jaque/my-workspace/zephyr/soc/starfive/jh71xx/Kconfig.defconfig"
osource "C:/Users/Jaque/my-workspace/zephyr/soc/st/stm32/Kconfig.defconfig"
osource "C:/Users/Jaque/my-workspace/zephyr/soc/snps/qemu_arc/Kconfig.defconfig"
osource "C:/Users/Jaque/my-workspace/zephyr/soc/snps/nsim/arc_v/Kconfig.defconfig"
osource "C:/Users/Jaque/my-workspace/zephyr/soc/snps/nsim/arc_classic/Kconfig.defconfig"
osource "C:/Users/Jaque/my-workspace/zephyr/soc/snps/hsdk4xd/Kconfig.defconfig"
osource "C:/Users/Jaque/my-workspace/zephyr/soc/snps/hsdk/Kconfig.defconfig"
osource "C:/Users/Jaque/my-workspace/zephyr/soc/snps/emsk/Kconfig.defconfig"
osource "C:/Users/Jaque/my-workspace/zephyr/soc/snps/emsdp/Kconfig.defconfig"
osource "C:/Users/Jaque/my-workspace/zephyr/soc/snps/arc_iot/Kconfig.defconfig"
osource "C:/Users/Jaque/my-workspace/zephyr/soc/silabs/Kconfig.defconfig"
osource "C:/Users/Jaque/my-workspace/zephyr/soc/sifli/sf32/Kconfig.defconfig"
osource "C:/Users/Jaque/my-workspace/zephyr/soc/sifive/sifive_freedom/Kconfig.defconfig"
osource "C:/Users/Jaque/my-workspace/zephyr/soc/sensry/Kconfig.defconfig"
osource "C:/Users/Jaque/my-workspace/zephyr/soc/rockchip/Kconfig.defconfig"
osource "C:/Users/Jaque/my-workspace/zephyr/soc/renode/riscv_virtual/Kconfig.defconfig"
osource "C:/Users/Jaque/my-workspace/zephyr/soc/renode/cortex_r8_virtual/Kconfig.defconfig"
osource "C:/Users/Jaque/my-workspace/zephyr/soc/renesas/smartbond/Kconfig.defconfig"
osource "C:/Users/Jaque/my-workspace/zephyr/soc/renesas/rz/Kconfig.defconfig"
osource "C:/Users/Jaque/my-workspace/zephyr/soc/renesas/rx/Kconfig.defconfig"
osource "C:/Users/Jaque/my-workspace/zephyr/soc/renesas/rcar/Kconfig.defconfig"
osource "C:/Users/Jaque/my-workspace/zephyr/soc/renesas/ra/Kconfig.defconfig"
osource "C:/Users/Jaque/my-workspace/zephyr/soc/realtek/ec/Kconfig.defconfig"
osource "C:/Users/Jaque/my-workspace/zephyr/soc/raspberrypi/rpi_pico/Kconfig.defconfig"
osource "C:/Users/Jaque/my-workspace/zephyr/soc/quicklogic/eos_s3/Kconfig.defconfig"
osource "C:/Users/Jaque/my-workspace/zephyr/soc/qemu/virt_riscv/Kconfig.defconfig"
osource "C:/Users/Jaque/my-workspace/zephyr/soc/qemu/malta/Kconfig.defconfig"
osource "C:/Users/Jaque/my-workspace/zephyr/soc/openisa/rv32m1/Kconfig.defconfig"
osource "C:/Users/Jaque/my-workspace/zephyr/soc/openhwgroup/cva6/Kconfig.defconfig"
osource "C:/Users/Jaque/my-workspace/zephyr/soc/oct/osd32mp15x/Kconfig.defconfig"
osource "C:/Users/Jaque/my-workspace/zephyr/soc/nxp/s32/Kconfig.defconfig"
osource "C:/Users/Jaque/my-workspace/zephyr/soc/nxp/rw/Kconfig.defconfig"
osource "C:/Users/Jaque/my-workspace/zephyr/soc/nxp/mcx/Kconfig.defconfig"
osource "C:/Users/Jaque/my-workspace/zephyr/soc/nxp/lpc/Kconfig.defconfig"
osource "C:/Users/Jaque/my-workspace/zephyr/soc/nxp/layerscape/Kconfig.defconfig"
osource "C:/Users/Jaque/my-workspace/zephyr/soc/nxp/kinetis/Kconfig.defconfig"
osource "C:/Users/Jaque/my-workspace/zephyr/soc/nxp/imxrt/Kconfig.defconfig"
osource "C:/Users/Jaque/my-workspace/zephyr/soc/nxp/imx/Kconfig.defconfig"
osource "C:/Users/Jaque/my-workspace/zephyr/soc/nuvoton/numicro/Kconfig.defconfig"
osource "C:/Users/Jaque/my-workspace/zephyr/soc/nuvoton/numaker/Kconfig.defconfig"
osource "C:/Users/Jaque/my-workspace/zephyr/soc/nuvoton/npcx/Kconfig.defconfig"
osource "C:/Users/Jaque/my-workspace/zephyr/soc/nuvoton/npcm/Kconfig.defconfig"
osource "C:/Users/Jaque/my-workspace/zephyr/soc/nordic/Kconfig.defconfig"
osource "C:/Users/Jaque/my-workspace/zephyr/soc/neorv32/Kconfig.defconfig"
osource "C:/Users/Jaque/my-workspace/zephyr/soc/native/inf_clock/Kconfig.defconfig"
osource "C:/Users/Jaque/my-workspace/zephyr/soc/microchip/sam/Kconfig.defconfig"
osource "C:/Users/Jaque/my-workspace/zephyr/soc/microchip/sam/sam_d5x_e5x/Kconfig.defconfig"
osource "C:/Users/Jaque/my-workspace/zephyr/soc/microchip/pic32c/pic32cm_jh/Kconfig.defconfig"
osource "C:/Users/Jaque/my-workspace/zephyr/soc/microchip/miv/Kconfig.defconfig"
osource "C:/Users/Jaque/my-workspace/zephyr/soc/microchip/mec/Kconfig.defconfig"
osource "C:/Users/Jaque/my-workspace/zephyr/soc/mediatek/mt8xxx/Kconfig.defconfig"
osource "C:/Users/Jaque/my-workspace/zephyr/soc/lowrisc/opentitan/Kconfig.defconfig"
osource "C:/Users/Jaque/my-workspace/zephyr/soc/litex/litex_vexriscv/Kconfig.defconfig"
osource "C:/Users/Jaque/my-workspace/zephyr/soc/ite/ec/Kconfig.defconfig"
osource "C:/Users/Jaque/my-workspace/zephyr/soc/intel/raptor_lake/Kconfig.defconfig"
osource "C:/Users/Jaque/my-workspace/zephyr/soc/intel/panther_lake/Kconfig.defconfig"
osource "C:/Users/Jaque/my-workspace/zephyr/soc/intel/lakemont/Kconfig.defconfig"
osource "C:/Users/Jaque/my-workspace/zephyr/soc/intel/intel_socfpga_std/Kconfig.defconfig"
osource "C:/Users/Jaque/my-workspace/zephyr/soc/intel/intel_socfpga/Kconfig.defconfig"
osource "C:/Users/Jaque/my-workspace/zephyr/soc/intel/intel_niosv/Kconfig.defconfig"
osource "C:/Users/Jaque/my-workspace/zephyr/soc/intel/intel_ish/Kconfig.defconfig"
osource "C:/Users/Jaque/my-workspace/zephyr/soc/intel/intel_adsp/Kconfig.defconfig"
osource "C:/Users/Jaque/my-workspace/zephyr/soc/intel/elkhart_lake/Kconfig.defconfig"
osource "C:/Users/Jaque/my-workspace/zephyr/soc/intel/atom/Kconfig.defconfig"
osource "C:/Users/Jaque/my-workspace/zephyr/soc/intel/apollo_lake/Kconfig.defconfig"
osource "C:/Users/Jaque/my-workspace/zephyr/soc/intel/alder_lake/Kconfig.defconfig"
osource "C:/Users/Jaque/my-workspace/zephyr/soc/infineon/cat3/Kconfig.defconfig"
osource "C:/Users/Jaque/my-workspace/zephyr/soc/infineon/cat1c/Kconfig.defconfig"
osource "C:/Users/Jaque/my-workspace/zephyr/soc/infineon/cat1b/Kconfig.defconfig"
osource "C:/Users/Jaque/my-workspace/zephyr/soc/infineon/cat1a/Kconfig.defconfig"
osource "C:/Users/Jaque/my-workspace/zephyr/soc/gd/gd32/Kconfig.defconfig"
osource "C:/Users/Jaque/my-workspace/zephyr/soc/gaisler/leon3/Kconfig.defconfig"
osource "C:/Users/Jaque/my-workspace/zephyr/soc/gaisler/gr716a/Kconfig.defconfig"
osource "C:/Users/Jaque/my-workspace/zephyr/soc/espressif/Kconfig.defconfig"
osource "C:/Users/Jaque/my-workspace/zephyr/soc/ene/kb1200/Kconfig.defconfig"
osource "C:/Users/Jaque/my-workspace/zephyr/soc/ene/kb106x/Kconfig.defconfig"
osource "C:/Users/Jaque/my-workspace/zephyr/soc/efinix/sapphire/Kconfig.defconfig"
osource "C:/Users/Jaque/my-workspace/zephyr/soc/cdns/xtensa_sample_controller/Kconfig.defconfig"
osource "C:/Users/Jaque/my-workspace/zephyr/soc/cdns/sample_controller32/Kconfig.defconfig"
osource "C:/Users/Jaque/my-workspace/zephyr/soc/cdns/dc233c/Kconfig.defconfig"
osource "C:/Users/Jaque/my-workspace/zephyr/soc/brcm/bcmvk/Kconfig.defconfig"
osource "C:/Users/Jaque/my-workspace/zephyr/soc/brcm/bcm2712/Kconfig.defconfig"
osource "C:/Users/Jaque/my-workspace/zephyr/soc/brcm/bcm2711/Kconfig.defconfig"
osource "C:/Users/Jaque/my-workspace/zephyr/soc/bflb/Kconfig.defconfig"
osource "C:/Users/Jaque/my-workspace/zephyr/soc/atmel/sam0/Kconfig.defconfig"
osource "C:/Users/Jaque/my-workspace/zephyr/soc/atmel/sam/Kconfig.defconfig"
osource "C:/Users/Jaque/my-workspace/zephyr/soc/aspeed/Kconfig.defconfig"
osource "C:/Users/Jaque/my-workspace/zephyr/soc/arm/Kconfig.defconfig"
osource "C:/Users/Jaque/my-workspace/zephyr/soc/arm/beetle/Kconfig.defconfig"
osource "C:/Users/Jaque/my-workspace/zephyr/soc/antmicro/myra/Kconfig.defconfig"
osource "C:/Users/Jaque/my-workspace/zephyr/soc/andestech/Kconfig.defconfig"
osource "C:/Users/Jaque/my-workspace/zephyr/soc/amd/acp_6_0/Kconfig.defconfig"
osource "C:/Users/Jaque/my-workspace/zephyr/soc/ambiq/Kconfig.defconfig"
osource "C:/Users/Jaque/my-workspace/zephyr/soc/aesc/Kconfig.defconfig"
osource "C:/Users/Jaque/my-workspace/zephyr/soc/adi/max32/Kconfig.defconfig"
```

## boards/arm/custom_plank/Kconfig.board
```kconfig
# Copyright (c) 2021 Nordic Semiconductor ASA
# SPDX-License-Identifier: Apache-2.0

config BOARD_CUSTOM_PLANK
	bool "Custom Plank Board"
	depends on SOC_NRF52840_QIAA
```

## boards/arm/custom_plank/Kconfig.defconfig
```kconfig
# Copyright (c) 2021 Nordic Semiconductor ASA
# SPDX-License-Identifier: Apache-2.0

if BOARD_CUSTOM_PLANK

config BOARD
	default "custom_plank"

endif # BOARD_CUSTOM_PLANK
```

## boards/arm/custom_plank/custom_plank_defconfig
```kconfig
# Copyright (c) 2021 Nordic Semiconductor ASA
# SPDX-License-Identifier: Apache-2.0

CONFIG_SOC_SERIES_NRF52X=y
CONFIG_SOC_NRF52840_QIAA=y
CONFIG_BOARD_CUSTOM_PLANK=y

CONFIG_ARM_MPU=y
CONFIG_HW_STACK_PROTECTION=y

CONFIG_GPIO=y
CONFIG_GPIO_AS_PINRESET=y

CONFIG_PINCTRL=y
```

## boards/vendor/custom_plank/Kconfig.custom_plank
```kconfig
# Copyright (c) 2021 Nordic Semiconductor ASA
# SPDX-License-Identifier: Apache-2.0

config BOARD_CUSTOM_PLANK
	select SOC_NRF52840_QIAA
```

## boards/vendor/custom_plank/board.yml
```yaml
# Copyright (c) 2024 Nordic Semiconductor ASA
# SPDX-License-Identifier: Apache-2.0

board:
  name: custom_plank
  full_name: Custom Plank
  vendor: vendor
  socs:
    - name: nrf52840
```

## boards/vendor/custom_plank/custom_plank_defconfig
```kconfig
# Copyright (c) 2021 Nordic Semiconductor ASA
# SPDX-License-Identifier: Apache-2.0

CONFIG_ARM_MPU=y
CONFIG_HW_STACK_PROTECTION=y

# Enable UART console on all configurations for convenience. This is usually
# done at board level upstream so that all samples output printed messages to
# the configured #zephyr,console. In production boards, this may be enabled at
# application level or in a debug configuration overlay.
CONFIG_SERIAL=y
CONFIG_CONSOLE=y
CONFIG_UART_CONSOLE=y

CONFIG_PINCTRL=y
```

## demo/central_peripheral_indicate_read_write/central_write_read/central_write/build/Kconfig/Kconfig.shield
```kconfig
osource "/home/jordan/Documents/PFE/appli/APPLICATION_WORKING/central_peripheral_indicate_read_write/peripheral_indicate_read_write/boards/shields/*/Kconfig.shield"
osource "/home/jordan/ncs/v2.5.1/nrf/boards/shields/*/Kconfig.shield"
```

## demo/central_peripheral_indicate_read_write/central_write_read/central_write/build/hci_rpmsg/Kconfig/Kconfig.modules
```kconfig
menu "nrf (/home/jordan/ncs/v2.5.1/nrf)"
osource "/home/jordan/ncs/v2.5.1/nrf/Kconfig.nrf"
config ZEPHYR_NRF_MODULE
	bool
	default y
endmenu
menu "wfa-qt-control-app (/home/jordan/ncs/v2.5.1/modules/lib/wfa-qt-control-app)"
osource "/home/jordan/ncs/v2.5.1/modules/lib/wfa-qt-control-app/zephyr/Kconfig"
config ZEPHYR_WFA_QT_CONTROL_APP_MODULE
	bool
	default y
endmenu
menu "mcuboot (/home/jordan/ncs/v2.5.1/bootloader/mcuboot)"
osource "$(ZEPHYR_MCUBOOT_KCONFIG)"
config ZEPHYR_MCUBOOT_MODULE
	bool
	default y
endmenu
menu "mbedtls (/home/jordan/ncs/v2.5.1/modules/crypto/mbedtls)"
osource "$(ZEPHYR_MBEDTLS_KCONFIG)"
config ZEPHYR_MBEDTLS_MODULE
	bool
	default y
endmenu
menu "trusted-firmware-m (/home/jordan/ncs/v2.5.1/modules/tee/tf-m/trusted-firmware-m)"
osource "$(ZEPHYR_TRUSTED_FIRMWARE_M_KCONFIG)"
config ZEPHYR_TRUSTED_FIRMWARE_M_MODULE
	bool
	default y
endmenu
menu "cjson (/home/jordan/ncs/v2.5.1/modules/lib/cjson)"
osource "$(ZEPHYR_CJSON_KCONFIG)"
config ZEPHYR_CJSON_MODULE
	bool
	default y
endmenu
menu "azure-sdk-for-c (/home/jordan/ncs/v2.5.1/modules/lib/azure-sdk-for-c)"
osource "$(ZEPHYR_AZURE_SDK_FOR_C_KCONFIG)"
config ZEPHYR_AZURE_SDK_FOR_C_MODULE
	bool
	default y
endmenu
menu "cirrus-logic (/home/jordan/ncs/v2.5.1/modules/hal/cirrus-logic)"
osource "/home/jordan/ncs/v2.5.1/modules/hal/cirrus-logic/Kconfig"
config ZEPHYR_CIRRUS_LOGIC_MODULE
	bool
	default y
endmenu
menu "openthread (/home/jordan/ncs/v2.5.1/modules/lib/openthread)"
osource "$(ZEPHYR_OPENTHREAD_KCONFIG)"
config ZEPHYR_OPENTHREAD_MODULE
	bool
	default y
endmenu
menu "memfault-firmware-sdk (/home/jordan/ncs/v2.5.1/modules/lib/memfault-firmware-sdk)"
osource "/home/jordan/ncs/v2.5.1/modules/lib/memfault-firmware-sdk/ports/zephyr/Kconfig"
config ZEPHYR_MEMFAULT_FIRMWARE_SDK_MODULE
	bool
	default y
endmenu
menu "canopennode (/home/jordan/ncs/v2.5.1/modules/lib/canopennode)"
osource "$(ZEPHYR_CANOPENNODE_KCONFIG)"
config ZEPHYR_CANOPENNODE_MODULE
	bool
	default y
endmenu
menu "chre (/home/jordan/ncs/v2.5.1/modules/lib/chre)"
osource "/home/jordan/ncs/v2.5.1/modules/lib/chre/platform/zephyr/Kconfig"
config ZEPHYR_CHRE_MODULE
	bool
	default y
endmenu
menu "cmsis (/home/jordan/ncs/v2.5.1/modules/hal/cmsis)"
osource "$(ZEPHYR_CMSIS_KCONFIG)"
config ZEPHYR_CMSIS_MODULE
	bool
	default y
endmenu
menu "fatfs (/home/jordan/ncs/v2.5.1/modules/fs/fatfs)"
osource "$(ZEPHYR_FATFS_KCONFIG)"
config ZEPHYR_FATFS_MODULE
	bool
	default y
endmenu
menu "hal_nordic (/home/jordan/ncs/v2.5.1/modules/hal/nordic)"
osource "$(ZEPHYR_HAL_NORDIC_KCONFIG)"
config ZEPHYR_HAL_NORDIC_MODULE
	bool
	default y
endmenu
menu "liblc3 (/home/jordan/ncs/v2.5.1/modules/lib/liblc3)"
osource "$(ZEPHYR_LIBLC3_KCONFIG)"
config ZEPHYR_LIBLC3_MODULE
	bool
	default y
endmenu
menu "littlefs (/home/jordan/ncs/v2.5.1/modules/fs/littlefs)"
osource "$(ZEPHYR_LITTLEFS_KCONFIG)"
config ZEPHYR_LITTLEFS_MODULE
	bool
	default y
endmenu
menu "loramac-node (/home/jordan/ncs/v2.5.1/modules/lib/loramac-node)"
osource "$(ZEPHYR_LORAMAC_NODE_KCONFIG)"
config ZEPHYR_LORAMAC_NODE_MODULE
	bool
	default y
endmenu
menu "lvgl (/home/jordan/ncs/v2.5.1/modules/lib/gui/lvgl)"
osource "/home/jordan/ncs/v2.5.1/modules/lib/gui/lvgl/Kconfig"
config ZEPHYR_LVGL_MODULE
	bool
	default y
endmenu
menu "lz4 (/home/jordan/ncs/v2.5.1/modules/lib/lz4)"
osource "$(ZEPHYR_LZ4_KCONFIG)"
config ZEPHYR_LZ4_MODULE
	bool
	default y
endmenu
menu "nanopb (/home/jordan/ncs/v2.5.1/modules/lib/nanopb)"
osource "$(ZEPHYR_NANOPB_KCONFIG)"
config ZEPHYR_NANOPB_MODULE
	bool
	default y
endmenu
menu "picolibc (/home/jordan/ncs/v2.5.1/modules/lib/picolibc)"
osource "/home/jordan/ncs/v2.5.1/modules/lib/picolibc/zephyr/Kconfig"
config ZEPHYR_PICOLIBC_MODULE
	bool
	default y
endmenu
menu "segger (/home/jordan/ncs/v2.5.1/modules/debug/segger)"
osource "$(ZEPHYR_SEGGER_KCONFIG)"
config ZEPHYR_SEGGER_MODULE
	bool
	default y
endmenu
menu "TraceRecorder (/home/jordan/ncs/v2.5.1/modules/debug/TraceRecorder)"
osource "/home/jordan/ncs/v2.5.1/modules/debug/TraceRecorder/kernelports/Zephyr/Kconfig"
config ZEPHYR_TRACERECORDER_MODULE
	bool
	default y
endmenu
menu "uoscore-uedhoc (/home/jordan/ncs/v2.5.1/modules/lib/uoscore-uedhoc)"
osource "$(ZEPHYR_UOSCORE_UEDHOC_KCONFIG)"
config ZEPHYR_UOSCORE_UEDHOC_MODULE
	bool
	default y
endmenu
menu "zcbor (/home/jordan/ncs/v2.5.1/modules/lib/zcbor)"
osource "$(ZEPHYR_ZCBOR_KCONFIG)"
config ZEPHYR_ZCBOR_MODULE
	bool
	default y
endmenu
menu "zscilib (/home/jordan/ncs/v2.5.1/modules/lib/zscilib)"
osource "/home/jordan/ncs/v2.5.1/modules/lib/zscilib/Kconfig.zscilib"
config ZEPHYR_ZSCILIB_MODULE
	bool
	default y
endmenu
menu "nrfxlib (/home/jordan/ncs/v2.5.1/nrfxlib)"
osource "/home/jordan/ncs/v2.5.1/nrfxlib/Kconfig.nrfxlib"
config ZEPHYR_NRFXLIB_MODULE
	bool
	default y
endmenu
menu "connectedhomeip (/home/jordan/ncs/v2.5.1/modules/lib/matter)"
osource "/home/jordan/ncs/v2.5.1/modules/lib/matter/config/nrfconnect/chip-module/Kconfig"
config ZEPHYR_CONNECTEDHOMEIP_MODULE
	bool
	default y
endmenu
```
