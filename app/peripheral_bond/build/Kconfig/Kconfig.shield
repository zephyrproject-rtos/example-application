## app/peripheral_bond/build/Kconfig/Kconfig.shield
```kconfig
osource "/home/jpedroli/Documents/workspace/pfe/boards/shields/*/Kconfig.shield"
```

## apps/novaapp/build/Kconfig/Kconfig.modules
```kconfig
menu "zephyr-app-ufsm00292.git (C:/Users/Jaque/my-workspace/zephyr-app-ufsm00292.git)"
osource "C:/Users/Jaque/my-workspace/zephyr-app-ufsm00292.git/Kconfig"
config ZEPHYR_ZEPHYR_APP_UFSM00292_GIT_MODULE
	bool
	default y
endmenu
menu "cmsis_6 (C:/Users/Jaque/my-workspace/modules/hal/cmsis_6)"
osource "$(ZEPHYR_CMSIS_6_KCONFIG)"
config ZEPHYR_CMSIS_6_MODULE
	bool
	default y
endmenu
menu "hal_nordic (C:/Users/Jaque/my-workspace/modules/hal/nordic)"
osource "$(ZEPHYR_HAL_NORDIC_KCONFIG)"
config ZEPHYR_HAL_NORDIC_MODULE
	bool
	default y

config ZEPHYR_HAL_NORDIC_MODULE_BLOBS
	bool
endmenu
config ZEPHYR_HAL_STM32_MODULE
	bool
	default y

config ZEPHYR_HAL_STM32_MODULE_BLOBS
	bool
```

## apps/novaapp/build/Kconfig/boards/Kconfig.defconfig
```kconfig
# Load Zephyr board defconfig descriptions.
osource "C:/Users/Jaque/my-workspace/zephyr/boards/st/nucleo_l476rg/Kconfig.defconfig"
```

## apps/novaapp/build/Kconfig/soc/Kconfig
```kconfig
# Load Zephyr SoC Kconfig descriptions.
osource "C:/Users/Jaque/my-workspace/zephyr/soc/xlnx/zynqmp/Kconfig"
osource "C:/Users/Jaque/my-workspace/zephyr/soc/xlnx/zynq7000/Kconfig"
osource "C:/Users/Jaque/my-workspace/zephyr/soc/xlnx/versalnet/Kconfig"
osource "C:/Users/Jaque/my-workspace/zephyr/soc/xlnx/versal2/Kconfig"
osource "C:/Users/Jaque/my-workspace/zephyr/soc/xen/Kconfig"
osource "C:/Users/Jaque/my-workspace/zephyr/soc/wch/ch32v/Kconfig"
osource "C:/Users/Jaque/my-workspace/zephyr/soc/ti/simplelink/Kconfig"
osource "C:/Users/Jaque/my-workspace/zephyr/soc/ti/mspm0/Kconfig"
osource "C:/Users/Jaque/my-workspace/zephyr/soc/ti/lm3s6965/Kconfig"
osource "C:/Users/Jaque/my-workspace/zephyr/soc/ti/k3/Kconfig"
osource "C:/Users/Jaque/my-workspace/zephyr/soc/telink/tlsr/Kconfig"
osource "C:/Users/Jaque/my-workspace/zephyr/soc/starfive/jh71xx/Kconfig"
osource "C:/Users/Jaque/my-workspace/zephyr/soc/st/stm32/Kconfig"
osource "C:/Users/Jaque/my-workspace/zephyr/soc/snps/qemu_arc/Kconfig"
osource "C:/Users/Jaque/my-workspace/zephyr/soc/snps/nsim/arc_v/Kconfig"
osource "C:/Users/Jaque/my-workspace/zephyr/soc/snps/nsim/arc_classic/Kconfig"
osource "C:/Users/Jaque/my-workspace/zephyr/soc/snps/hsdk4xd/Kconfig"
osource "C:/Users/Jaque/my-workspace/zephyr/soc/snps/hsdk/Kconfig"
osource "C:/Users/Jaque/my-workspace/zephyr/soc/snps/emsk/Kconfig"
osource "C:/Users/Jaque/my-workspace/zephyr/soc/snps/emsdp/Kconfig"
osource "C:/Users/Jaque/my-workspace/zephyr/soc/snps/arc_iot/Kconfig"
osource "C:/Users/Jaque/my-workspace/zephyr/soc/silabs/Kconfig"
osource "C:/Users/Jaque/my-workspace/zephyr/soc/sifli/sf32/Kconfig"
osource "C:/Users/Jaque/my-workspace/zephyr/soc/sifive/sifive_freedom/Kconfig"
osource "C:/Users/Jaque/my-workspace/zephyr/soc/sensry/Kconfig"
osource "C:/Users/Jaque/my-workspace/zephyr/soc/rockchip/Kconfig"
osource "C:/Users/Jaque/my-workspace/zephyr/soc/renode/riscv_virtual/Kconfig"
osource "C:/Users/Jaque/my-workspace/zephyr/soc/renode/cortex_r8_virtual/Kconfig"
osource "C:/Users/Jaque/my-workspace/zephyr/soc/renesas/smartbond/Kconfig"
osource "C:/Users/Jaque/my-workspace/zephyr/soc/renesas/rz/Kconfig"
osource "C:/Users/Jaque/my-workspace/zephyr/soc/renesas/rx/Kconfig"
osource "C:/Users/Jaque/my-workspace/zephyr/soc/renesas/rcar/Kconfig"
osource "C:/Users/Jaque/my-workspace/zephyr/soc/renesas/ra/Kconfig"
osource "C:/Users/Jaque/my-workspace/zephyr/soc/realtek/ec/Kconfig"
osource "C:/Users/Jaque/my-workspace/zephyr/soc/raspberrypi/rpi_pico/Kconfig"
osource "C:/Users/Jaque/my-workspace/zephyr/soc/quicklogic/eos_s3/Kconfig"
osource "C:/Users/Jaque/my-workspace/zephyr/soc/qemu/virt_riscv/Kconfig"
osource "C:/Users/Jaque/my-workspace/zephyr/soc/qemu/malta/Kconfig"
osource "C:/Users/Jaque/my-workspace/zephyr/soc/openisa/rv32m1/Kconfig"
osource "C:/Users/Jaque/my-workspace/zephyr/soc/openhwgroup/cva6/Kconfig"
osource "C:/Users/Jaque/my-workspace/zephyr/soc/oct/osd32mp15x/Kconfig"
osource "C:/Users/Jaque/my-workspace/zephyr/soc/nxp/s32/Kconfig"
osource "C:/Users/Jaque/my-workspace/zephyr/soc/nxp/rw/Kconfig"
osource "C:/Users/Jaque/my-workspace/zephyr/soc/nxp/mcx/Kconfig"
osource "C:/Users/Jaque/my-workspace/zephyr/soc/nxp/lpc/Kconfig"
osource "C:/Users/Jaque/my-workspace/zephyr/soc/nxp/layerscape/Kconfig"
osource "C:/Users/Jaque/my-workspace/zephyr/soc/nxp/kinetis/Kconfig"
osource "C:/Users/Jaque/my-workspace/zephyr/soc/nxp/imxrt/Kconfig"
osource "C:/Users/Jaque/my-workspace/zephyr/soc/nxp/imx/Kconfig"
osource "C:/Users/Jaque/my-workspace/zephyr/soc/nuvoton/numicro/Kconfig"
osource "C:/Users/Jaque/my-workspace/zephyr/soc/nuvoton/numaker/Kconfig"
osource "C:/Users/Jaque/my-workspace/zephyr/soc/nuvoton/npcx/Kconfig"
osource "C:/Users/Jaque/my-workspace/zephyr/soc/nuvoton/npcm/Kconfig"
osource "C:/Users/Jaque/my-workspace/zephyr/soc/nordic/Kconfig"
osource "C:/Users/Jaque/my-workspace/zephyr/soc/neorv32/Kconfig"
osource "C:/Users/Jaque/my-workspace/zephyr/soc/native/inf_clock/Kconfig"
osource "C:/Users/Jaque/my-workspace/zephyr/soc/microchip/sam/Kconfig"
osource "C:/Users/Jaque/my-workspace/zephyr/soc/microchip/sam/sam_d5x_e5x/Kconfig"
osource "C:/Users/Jaque/my-workspace/zephyr/soc/microchip/pic32c/pic32cm_jh/Kconfig"
osource "C:/Users/Jaque/my-workspace/zephyr/soc/microchip/miv/Kconfig"
osource "C:/Users/Jaque/my-workspace/zephyr/soc/microchip/mec/Kconfig"
osource "C:/Users/Jaque/my-workspace/zephyr/soc/mediatek/mt8xxx/Kconfig"
osource "C:/Users/Jaque/my-workspace/zephyr/soc/lowrisc/opentitan/Kconfig"
osource "C:/Users/Jaque/my-workspace/zephyr/soc/litex/litex_vexriscv/Kconfig"
osource "C:/Users/Jaque/my-workspace/zephyr/soc/ite/ec/Kconfig"
osource "C:/Users/Jaque/my-workspace/zephyr/soc/intel/raptor_lake/Kconfig"
osource "C:/Users/Jaque/my-workspace/zephyr/soc/intel/panther_lake/Kconfig"
osource "C:/Users/Jaque/my-workspace/zephyr/soc/intel/lakemont/Kconfig"
osource "C:/Users/Jaque/my-workspace/zephyr/soc/intel/intel_socfpga_std/Kconfig"
osource "C:/Users/Jaque/my-workspace/zephyr/soc/intel/intel_socfpga/Kconfig"
osource "C:/Users/Jaque/my-workspace/zephyr/soc/intel/intel_niosv/Kconfig"
osource "C:/Users/Jaque/my-workspace/zephyr/soc/intel/intel_ish/Kconfig"
osource "C:/Users/Jaque/my-workspace/zephyr/soc/intel/intel_adsp/Kconfig"
osource "C:/Users/Jaque/my-workspace/zephyr/soc/intel/elkhart_lake/Kconfig"
osource "C:/Users/Jaque/my-workspace/zephyr/soc/intel/atom/Kconfig"
osource "C:/Users/Jaque/my-workspace/zephyr/soc/intel/apollo_lake/Kconfig"
osource "C:/Users/Jaque/my-workspace/zephyr/soc/intel/alder_lake/Kconfig"
osource "C:/Users/Jaque/my-workspace/zephyr/soc/infineon/cat3/Kconfig"
osource "C:/Users/Jaque/my-workspace/zephyr/soc/infineon/cat1c/Kconfig"
osource "C:/Users/Jaque/my-workspace/zephyr/soc/infineon/cat1b/Kconfig"
osource "C:/Users/Jaque/my-workspace/zephyr/soc/infineon/cat1a/Kconfig"
osource "C:/Users/Jaque/my-workspace/zephyr/soc/gd/gd32/Kconfig"
osource "C:/Users/Jaque/my-workspace/zephyr/soc/gaisler/leon3/Kconfig"
osource "C:/Users/Jaque/my-workspace/zephyr/soc/gaisler/gr716a/Kconfig"
osource "C:/Users/Jaque/my-workspace/zephyr/soc/espressif/Kconfig"
osource "C:/Users/Jaque/my-workspace/zephyr/soc/ene/kb1200/Kconfig"
osource "C:/Users/Jaque/my-workspace/zephyr/soc/ene/kb106x/Kconfig"
osource "C:/Users/Jaque/my-workspace/zephyr/soc/efinix/sapphire/Kconfig"
osource "C:/Users/Jaque/my-workspace/zephyr/soc/cdns/xtensa_sample_controller/Kconfig"
osource "C:/Users/Jaque/my-workspace/zephyr/soc/cdns/sample_controller32/Kconfig"
osource "C:/Users/Jaque/my-workspace/zephyr/soc/cdns/dc233c/Kconfig"
osource "C:/Users/Jaque/my-workspace/zephyr/soc/brcm/bcmvk/Kconfig"
osource "C:/Users/Jaque/my-workspace/zephyr/soc/brcm/bcm2712/Kconfig"
osource "C:/Users/Jaque/my-workspace/zephyr/soc/brcm/bcm2711/Kconfig"
osource "C:/Users/Jaque/my-workspace/zephyr/soc/bflb/Kconfig"
osource "C:/Users/Jaque/my-workspace/zephyr/soc/atmel/sam0/Kconfig"
osource "C:/Users/Jaque/my-workspace/zephyr/soc/atmel/sam/Kconfig"
osource "C:/Users/Jaque/my-workspace/zephyr/soc/aspeed/Kconfig"
osource "C:/Users/Jaque/my-workspace/zephyr/soc/arm/Kconfig"
osource "C:/Users/Jaque/my-workspace/zephyr/soc/arm/beetle/Kconfig"
osource "C:/Users/Jaque/my-workspace/zephyr/soc/antmicro/myra/Kconfig"
osource "C:/Users/Jaque/my-workspace/zephyr/soc/andestech/Kconfig"
osource "C:/Users/Jaque/my-workspace/zephyr/soc/amd/acp_6_0/Kconfig"
osource "C:/Users/Jaque/my-workspace/zephyr/soc/ambiq/Kconfig"
osource "C:/Users/Jaque/my-workspace/zephyr/soc/aesc/Kconfig"
osource "C:/Users/Jaque/my-workspace/zephyr/soc/adi/max32/Kconfig"
```
