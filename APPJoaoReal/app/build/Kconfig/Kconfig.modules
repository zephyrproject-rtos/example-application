## AppLenon/blinktest/build/Kconfig/soc/Kconfig.sysbuild
```kconfig
# Load Sysbuild SoC Kconfig descriptions.
osource "C:/Users/Lenon/zephyrproject/zephyr/soc/xlnx/zynqmp/Kconfig.sysbuild"
osource "C:/Users/Lenon/zephyrproject/zephyr/soc/xlnx/zynq7000/Kconfig.sysbuild"
osource "C:/Users/Lenon/zephyrproject/zephyr/soc/xlnx/versalnet/Kconfig.sysbuild"
osource "C:/Users/Lenon/zephyrproject/zephyr/soc/xlnx/versal2/Kconfig.sysbuild"
osource "C:/Users/Lenon/zephyrproject/zephyr/soc/xen/Kconfig.sysbuild"
osource "C:/Users/Lenon/zephyrproject/zephyr/soc/wch/ch32v/Kconfig.sysbuild"
osource "C:/Users/Lenon/zephyrproject/zephyr/soc/ti/simplelink/Kconfig.sysbuild"
osource "C:/Users/Lenon/zephyrproject/zephyr/soc/ti/mspm0/Kconfig.sysbuild"
osource "C:/Users/Lenon/zephyrproject/zephyr/soc/ti/lm3s6965/Kconfig.sysbuild"
osource "C:/Users/Lenon/zephyrproject/zephyr/soc/ti/k3/Kconfig.sysbuild"
osource "C:/Users/Lenon/zephyrproject/zephyr/soc/telink/tlsr/Kconfig.sysbuild"
osource "C:/Users/Lenon/zephyrproject/zephyr/soc/starfive/jh71xx/Kconfig.sysbuild"
osource "C:/Users/Lenon/zephyrproject/zephyr/soc/st/stm32/Kconfig.sysbuild"
osource "C:/Users/Lenon/zephyrproject/zephyr/soc/snps/qemu_arc/Kconfig.sysbuild"
osource "C:/Users/Lenon/zephyrproject/zephyr/soc/snps/nsim/arc_v/Kconfig.sysbuild"
osource "C:/Users/Lenon/zephyrproject/zephyr/soc/snps/nsim/arc_classic/Kconfig.sysbuild"
osource "C:/Users/Lenon/zephyrproject/zephyr/soc/snps/hsdk4xd/Kconfig.sysbuild"
osource "C:/Users/Lenon/zephyrproject/zephyr/soc/snps/hsdk/Kconfig.sysbuild"
osource "C:/Users/Lenon/zephyrproject/zephyr/soc/snps/emsk/Kconfig.sysbuild"
osource "C:/Users/Lenon/zephyrproject/zephyr/soc/snps/emsdp/Kconfig.sysbuild"
osource "C:/Users/Lenon/zephyrproject/zephyr/soc/snps/arc_iot/Kconfig.sysbuild"
osource "C:/Users/Lenon/zephyrproject/zephyr/soc/silabs/Kconfig.sysbuild"
osource "C:/Users/Lenon/zephyrproject/zephyr/soc/sifli/sf32/Kconfig.sysbuild"
osource "C:/Users/Lenon/zephyrproject/zephyr/soc/sifive/sifive_freedom/Kconfig.sysbuild"
osource "C:/Users/Lenon/zephyrproject/zephyr/soc/sensry/Kconfig.sysbuild"
osource "C:/Users/Lenon/zephyrproject/zephyr/soc/rockchip/Kconfig.sysbuild"
osource "C:/Users/Lenon/zephyrproject/zephyr/soc/renode/riscv_virtual/Kconfig.sysbuild"
osource "C:/Users/Lenon/zephyrproject/zephyr/soc/renode/cortex_r8_virtual/Kconfig.sysbuild"
osource "C:/Users/Lenon/zephyrproject/zephyr/soc/renesas/smartbond/Kconfig.sysbuild"
osource "C:/Users/Lenon/zephyrproject/zephyr/soc/renesas/rz/Kconfig.sysbuild"
osource "C:/Users/Lenon/zephyrproject/zephyr/soc/renesas/rx/Kconfig.sysbuild"
osource "C:/Users/Lenon/zephyrproject/zephyr/soc/renesas/rcar/Kconfig.sysbuild"
osource "C:/Users/Lenon/zephyrproject/zephyr/soc/renesas/ra/Kconfig.sysbuild"
osource "C:/Users/Lenon/zephyrproject/zephyr/soc/realtek/ec/Kconfig.sysbuild"
osource "C:/Users/Lenon/zephyrproject/zephyr/soc/raspberrypi/rpi_pico/Kconfig.sysbuild"
osource "C:/Users/Lenon/zephyrproject/zephyr/soc/quicklogic/eos_s3/Kconfig.sysbuild"
osource "C:/Users/Lenon/zephyrproject/zephyr/soc/qemu/virt_riscv/Kconfig.sysbuild"
osource "C:/Users/Lenon/zephyrproject/zephyr/soc/qemu/malta/Kconfig.sysbuild"
osource "C:/Users/Lenon/zephyrproject/zephyr/soc/openisa/rv32m1/Kconfig.sysbuild"
osource "C:/Users/Lenon/zephyrproject/zephyr/soc/openhwgroup/cva6/Kconfig.sysbuild"
osource "C:/Users/Lenon/zephyrproject/zephyr/soc/oct/osd32mp15x/Kconfig.sysbuild"
osource "C:/Users/Lenon/zephyrproject/zephyr/soc/nxp/s32/Kconfig.sysbuild"
osource "C:/Users/Lenon/zephyrproject/zephyr/soc/nxp/rw/Kconfig.sysbuild"
osource "C:/Users/Lenon/zephyrproject/zephyr/soc/nxp/mcx/Kconfig.sysbuild"
osource "C:/Users/Lenon/zephyrproject/zephyr/soc/nxp/lpc/Kconfig.sysbuild"
osource "C:/Users/Lenon/zephyrproject/zephyr/soc/nxp/layerscape/Kconfig.sysbuild"
osource "C:/Users/Lenon/zephyrproject/zephyr/soc/nxp/kinetis/Kconfig.sysbuild"
osource "C:/Users/Lenon/zephyrproject/zephyr/soc/nxp/imxrt/Kconfig.sysbuild"
osource "C:/Users/Lenon/zephyrproject/zephyr/soc/nxp/imx/Kconfig.sysbuild"
osource "C:/Users/Lenon/zephyrproject/zephyr/soc/nuvoton/numicro/Kconfig.sysbuild"
osource "C:/Users/Lenon/zephyrproject/zephyr/soc/nuvoton/numaker/Kconfig.sysbuild"
osource "C:/Users/Lenon/zephyrproject/zephyr/soc/nuvoton/npcx/Kconfig.sysbuild"
osource "C:/Users/Lenon/zephyrproject/zephyr/soc/nuvoton/npcm/Kconfig.sysbuild"
osource "C:/Users/Lenon/zephyrproject/zephyr/soc/nordic/Kconfig.sysbuild"
osource "C:/Users/Lenon/zephyrproject/zephyr/soc/neorv32/Kconfig.sysbuild"
osource "C:/Users/Lenon/zephyrproject/zephyr/soc/native/inf_clock/Kconfig.sysbuild"
osource "C:/Users/Lenon/zephyrproject/zephyr/soc/microchip/sam/Kconfig.sysbuild"
osource "C:/Users/Lenon/zephyrproject/zephyr/soc/microchip/sam/sam_d5x_e5x/Kconfig.sysbuild"
osource "C:/Users/Lenon/zephyrproject/zephyr/soc/microchip/pic32c/pic32cm_jh/Kconfig.sysbuild"
osource "C:/Users/Lenon/zephyrproject/zephyr/soc/microchip/miv/Kconfig.sysbuild"
osource "C:/Users/Lenon/zephyrproject/zephyr/soc/microchip/mec/Kconfig.sysbuild"
osource "C:/Users/Lenon/zephyrproject/zephyr/soc/mediatek/mt8xxx/Kconfig.sysbuild"
osource "C:/Users/Lenon/zephyrproject/zephyr/soc/lowrisc/opentitan/Kconfig.sysbuild"
osource "C:/Users/Lenon/zephyrproject/zephyr/soc/litex/litex_vexriscv/Kconfig.sysbuild"
osource "C:/Users/Lenon/zephyrproject/zephyr/soc/ite/ec/Kconfig.sysbuild"
osource "C:/Users/Lenon/zephyrproject/zephyr/soc/intel/raptor_lake/Kconfig.sysbuild"
osource "C:/Users/Lenon/zephyrproject/zephyr/soc/intel/panther_lake/Kconfig.sysbuild"
osource "C:/Users/Lenon/zephyrproject/zephyr/soc/intel/lakemont/Kconfig.sysbuild"
osource "C:/Users/Lenon/zephyrproject/zephyr/soc/intel/intel_socfpga_std/Kconfig.sysbuild"
osource "C:/Users/Lenon/zephyrproject/zephyr/soc/intel/intel_socfpga/Kconfig.sysbuild"
osource "C:/Users/Lenon/zephyrproject/zephyr/soc/intel/intel_niosv/Kconfig.sysbuild"
osource "C:/Users/Lenon/zephyrproject/zephyr/soc/intel/intel_ish/Kconfig.sysbuild"
osource "C:/Users/Lenon/zephyrproject/zephyr/soc/intel/intel_adsp/Kconfig.sysbuild"
osource "C:/Users/Lenon/zephyrproject/zephyr/soc/intel/elkhart_lake/Kconfig.sysbuild"
osource "C:/Users/Lenon/zephyrproject/zephyr/soc/intel/atom/Kconfig.sysbuild"
osource "C:/Users/Lenon/zephyrproject/zephyr/soc/intel/apollo_lake/Kconfig.sysbuild"
osource "C:/Users/Lenon/zephyrproject/zephyr/soc/intel/alder_lake/Kconfig.sysbuild"
osource "C:/Users/Lenon/zephyrproject/zephyr/soc/infineon/cat3/Kconfig.sysbuild"
osource "C:/Users/Lenon/zephyrproject/zephyr/soc/infineon/cat1c/Kconfig.sysbuild"
osource "C:/Users/Lenon/zephyrproject/zephyr/soc/infineon/cat1b/Kconfig.sysbuild"
osource "C:/Users/Lenon/zephyrproject/zephyr/soc/infineon/cat1a/Kconfig.sysbuild"
osource "C:/Users/Lenon/zephyrproject/zephyr/soc/gd/gd32/Kconfig.sysbuild"
osource "C:/Users/Lenon/zephyrproject/zephyr/soc/gaisler/leon3/Kconfig.sysbuild"
osource "C:/Users/Lenon/zephyrproject/zephyr/soc/gaisler/gr716a/Kconfig.sysbuild"
osource "C:/Users/Lenon/zephyrproject/zephyr/soc/espressif/Kconfig.sysbuild"
osource "C:/Users/Lenon/zephyrproject/zephyr/soc/ene/kb1200/Kconfig.sysbuild"
osource "C:/Users/Lenon/zephyrproject/zephyr/soc/ene/kb106x/Kconfig.sysbuild"
osource "C:/Users/Lenon/zephyrproject/zephyr/soc/efinix/sapphire/Kconfig.sysbuild"
osource "C:/Users/Lenon/zephyrproject/zephyr/soc/cdns/xtensa_sample_controller/Kconfig.sysbuild"
osource "C:/Users/Lenon/zephyrproject/zephyr/soc/cdns/sample_controller32/Kconfig.sysbuild"
osource "C:/Users/Lenon/zephyrproject/zephyr/soc/cdns/dc233c/Kconfig.sysbuild"
osource "C:/Users/Lenon/zephyrproject/zephyr/soc/brcm/bcmvk/Kconfig.sysbuild"
osource "C:/Users/Lenon/zephyrproject/zephyr/soc/brcm/bcm2712/Kconfig.sysbuild"
osource "C:/Users/Lenon/zephyrproject/zephyr/soc/brcm/bcm2711/Kconfig.sysbuild"
osource "C:/Users/Lenon/zephyrproject/zephyr/soc/bflb/Kconfig.sysbuild"
osource "C:/Users/Lenon/zephyrproject/zephyr/soc/atmel/sam0/Kconfig.sysbuild"
osource "C:/Users/Lenon/zephyrproject/zephyr/soc/atmel/sam/Kconfig.sysbuild"
osource "C:/Users/Lenon/zephyrproject/zephyr/soc/aspeed/Kconfig.sysbuild"
osource "C:/Users/Lenon/zephyrproject/zephyr/soc/arm/Kconfig.sysbuild"
osource "C:/Users/Lenon/zephyrproject/zephyr/soc/arm/beetle/Kconfig.sysbuild"
osource "C:/Users/Lenon/zephyrproject/zephyr/soc/antmicro/myra/Kconfig.sysbuild"
osource "C:/Users/Lenon/zephyrproject/zephyr/soc/andestech/Kconfig.sysbuild"
osource "C:/Users/Lenon/zephyrproject/zephyr/soc/amd/acp_6_0/Kconfig.sysbuild"
osource "C:/Users/Lenon/zephyrproject/zephyr/soc/ambiq/Kconfig.sysbuild"
osource "C:/Users/Lenon/zephyrproject/zephyr/soc/aesc/Kconfig.sysbuild"
osource "C:/Users/Lenon/zephyrproject/zephyr/soc/adi/max32/Kconfig.sysbuild"
```

## AppLenon/temp_sensor_app/build/Kconfig/boards/Kconfig.defconfig
```kconfig
# Load Zephyr board defconfig descriptions.
osource "C:/Users/Lenon/zephyrproject/zephyr/boards/qemu/x86/Kconfig.defconfig"
```

## AppLenon/temp_sensor_app/build/Kconfig/boards/Kconfig.samr21_xpro
```kconfig
# Load board Kconfig descriptions.
osource "C:/Users/Lenon/zephyrproject/zephyr/boards/atmel/sam0/samr21_xpro/Kconfig.samr21_xpro"
```

## AppLenon/temp_sensor_app/build/Kconfig/boards/Kconfig.sysbuild
```kconfig
# Load Sysbuild board Kconfig descriptions.
osource "C:/Users/Lenon/zephyrproject/zephyr/boards/qemu/x86/Kconfig.sysbuild"
```

## AppLenon/teste app/build/Kconfig/boards/Kconfig.qemu_x86
```kconfig
# Load board Kconfig descriptions.
osource "C:/Users/Lenon/zephyrproject/zephyr/boards/qemu/x86/Kconfig.qemu_x86"
```
