## APP_gfschuster/build/Kconfig/soc/Kconfig
```kconfig
# Load Zephyr SoC Kconfig descriptions.
osource "C:/zephyrproject/zephyr/soc/xlnx/zynqmp/Kconfig"
osource "C:/zephyrproject/zephyr/soc/xlnx/zynq7000/Kconfig"
osource "C:/zephyrproject/zephyr/soc/xlnx/versalnet/Kconfig"
osource "C:/zephyrproject/zephyr/soc/xlnx/versal2/Kconfig"
osource "C:/zephyrproject/zephyr/soc/xen/Kconfig"
osource "C:/zephyrproject/zephyr/soc/wch/ch32v/Kconfig"
osource "C:/zephyrproject/zephyr/soc/ti/simplelink/Kconfig"
osource "C:/zephyrproject/zephyr/soc/ti/mspm0/Kconfig"
osource "C:/zephyrproject/zephyr/soc/ti/lm3s6965/Kconfig"
osource "C:/zephyrproject/zephyr/soc/ti/k3/Kconfig"
osource "C:/zephyrproject/zephyr/soc/telink/tlsr/Kconfig"
osource "C:/zephyrproject/zephyr/soc/starfive/jh71xx/Kconfig"
osource "C:/zephyrproject/zephyr/soc/st/stm32/Kconfig"
osource "C:/zephyrproject/zephyr/soc/snps/qemu_arc/Kconfig"
osource "C:/zephyrproject/zephyr/soc/snps/nsim/arc_v/Kconfig"
osource "C:/zephyrproject/zephyr/soc/snps/nsim/arc_classic/Kconfig"
osource "C:/zephyrproject/zephyr/soc/snps/hsdk4xd/Kconfig"
osource "C:/zephyrproject/zephyr/soc/snps/hsdk/Kconfig"
osource "C:/zephyrproject/zephyr/soc/snps/emsk/Kconfig"
osource "C:/zephyrproject/zephyr/soc/snps/emsdp/Kconfig"
osource "C:/zephyrproject/zephyr/soc/snps/arc_iot/Kconfig"
osource "C:/zephyrproject/zephyr/soc/silabs/Kconfig"
osource "C:/zephyrproject/zephyr/soc/sifli/sf32/Kconfig"
osource "C:/zephyrproject/zephyr/soc/sifive/sifive_freedom/Kconfig"
osource "C:/zephyrproject/zephyr/soc/sensry/Kconfig"
osource "C:/zephyrproject/zephyr/soc/rockchip/Kconfig"
osource "C:/zephyrproject/zephyr/soc/renode/riscv_virtual/Kconfig"
osource "C:/zephyrproject/zephyr/soc/renode/cortex_r8_virtual/Kconfig"
osource "C:/zephyrproject/zephyr/soc/renesas/smartbond/Kconfig"
osource "C:/zephyrproject/zephyr/soc/renesas/rz/Kconfig"
osource "C:/zephyrproject/zephyr/soc/renesas/rx/Kconfig"
osource "C:/zephyrproject/zephyr/soc/renesas/rcar/Kconfig"
osource "C:/zephyrproject/zephyr/soc/renesas/ra/Kconfig"
osource "C:/zephyrproject/zephyr/soc/realtek/ec/Kconfig"
osource "C:/zephyrproject/zephyr/soc/raspberrypi/rpi_pico/Kconfig"
osource "C:/zephyrproject/zephyr/soc/quicklogic/eos_s3/Kconfig"
osource "C:/zephyrproject/zephyr/soc/qemu/virt_riscv/Kconfig"
osource "C:/zephyrproject/zephyr/soc/qemu/malta/Kconfig"
osource "C:/zephyrproject/zephyr/soc/openisa/rv32m1/Kconfig"
osource "C:/zephyrproject/zephyr/soc/openhwgroup/cva6/Kconfig"
osource "C:/zephyrproject/zephyr/soc/oct/osd32mp15x/Kconfig"
osource "C:/zephyrproject/zephyr/soc/nxp/s32/Kconfig"
osource "C:/zephyrproject/zephyr/soc/nxp/rw/Kconfig"
osource "C:/zephyrproject/zephyr/soc/nxp/mcx/Kconfig"
osource "C:/zephyrproject/zephyr/soc/nxp/lpc/Kconfig"
osource "C:/zephyrproject/zephyr/soc/nxp/layerscape/Kconfig"
osource "C:/zephyrproject/zephyr/soc/nxp/kinetis/Kconfig"
osource "C:/zephyrproject/zephyr/soc/nxp/imxrt/Kconfig"
osource "C:/zephyrproject/zephyr/soc/nxp/imx/Kconfig"
osource "C:/zephyrproject/zephyr/soc/nuvoton/numicro/Kconfig"
osource "C:/zephyrproject/zephyr/soc/nuvoton/numaker/Kconfig"
osource "C:/zephyrproject/zephyr/soc/nuvoton/npcx/Kconfig"
osource "C:/zephyrproject/zephyr/soc/nuvoton/npcm/Kconfig"
osource "C:/zephyrproject/zephyr/soc/nordic/Kconfig"
osource "C:/zephyrproject/zephyr/soc/neorv32/Kconfig"
osource "C:/zephyrproject/zephyr/soc/native/inf_clock/Kconfig"
osource "C:/zephyrproject/zephyr/soc/microchip/sam/Kconfig"
osource "C:/zephyrproject/zephyr/soc/microchip/sam/sam_d5x_e5x/Kconfig"
osource "C:/zephyrproject/zephyr/soc/microchip/pic32c/pic32cm_jh/Kconfig"
osource "C:/zephyrproject/zephyr/soc/microchip/miv/Kconfig"
osource "C:/zephyrproject/zephyr/soc/microchip/mec/Kconfig"
osource "C:/zephyrproject/zephyr/soc/mediatek/mt8xxx/Kconfig"
osource "C:/zephyrproject/zephyr/soc/lowrisc/opentitan/Kconfig"
osource "C:/zephyrproject/zephyr/soc/litex/litex_vexriscv/Kconfig"
osource "C:/zephyrproject/zephyr/soc/ite/ec/Kconfig"
osource "C:/zephyrproject/zephyr/soc/intel/raptor_lake/Kconfig"
osource "C:/zephyrproject/zephyr/soc/intel/panther_lake/Kconfig"
osource "C:/zephyrproject/zephyr/soc/intel/lakemont/Kconfig"
osource "C:/zephyrproject/zephyr/soc/intel/intel_socfpga_std/Kconfig"
osource "C:/zephyrproject/zephyr/soc/intel/intel_socfpga/Kconfig"
osource "C:/zephyrproject/zephyr/soc/intel/intel_niosv/Kconfig"
osource "C:/zephyrproject/zephyr/soc/intel/intel_ish/Kconfig"
osource "C:/zephyrproject/zephyr/soc/intel/intel_adsp/Kconfig"
osource "C:/zephyrproject/zephyr/soc/intel/elkhart_lake/Kconfig"
osource "C:/zephyrproject/zephyr/soc/intel/atom/Kconfig"
osource "C:/zephyrproject/zephyr/soc/intel/apollo_lake/Kconfig"
osource "C:/zephyrproject/zephyr/soc/intel/alder_lake/Kconfig"
osource "C:/zephyrproject/zephyr/soc/infineon/cat3/Kconfig"
osource "C:/zephyrproject/zephyr/soc/infineon/cat1c/Kconfig"
osource "C:/zephyrproject/zephyr/soc/infineon/cat1b/Kconfig"
osource "C:/zephyrproject/zephyr/soc/infineon/cat1a/Kconfig"
osource "C:/zephyrproject/zephyr/soc/gd/gd32/Kconfig"
osource "C:/zephyrproject/zephyr/soc/gaisler/leon3/Kconfig"
osource "C:/zephyrproject/zephyr/soc/gaisler/gr716a/Kconfig"
osource "C:/zephyrproject/zephyr/soc/espressif/Kconfig"
osource "C:/zephyrproject/zephyr/soc/ene/kb1200/Kconfig"
osource "C:/zephyrproject/zephyr/soc/ene/kb106x/Kconfig"
osource "C:/zephyrproject/zephyr/soc/efinix/sapphire/Kconfig"
osource "C:/zephyrproject/zephyr/soc/cdns/xtensa_sample_controller/Kconfig"
osource "C:/zephyrproject/zephyr/soc/cdns/sample_controller32/Kconfig"
osource "C:/zephyrproject/zephyr/soc/cdns/dc233c/Kconfig"
osource "C:/zephyrproject/zephyr/soc/brcm/bcmvk/Kconfig"
osource "C:/zephyrproject/zephyr/soc/brcm/bcm2712/Kconfig"
osource "C:/zephyrproject/zephyr/soc/brcm/bcm2711/Kconfig"
osource "C:/zephyrproject/zephyr/soc/bflb/Kconfig"
osource "C:/zephyrproject/zephyr/soc/atmel/sam0/Kconfig"
osource "C:/zephyrproject/zephyr/soc/atmel/sam/Kconfig"
osource "C:/zephyrproject/zephyr/soc/aspeed/Kconfig"
osource "C:/zephyrproject/zephyr/soc/arm/Kconfig"
osource "C:/zephyrproject/zephyr/soc/arm/beetle/Kconfig"
osource "C:/zephyrproject/zephyr/soc/antmicro/myra/Kconfig"
osource "C:/zephyrproject/zephyr/soc/andestech/Kconfig"
osource "C:/zephyrproject/zephyr/soc/amd/acp_6_0/Kconfig"
osource "C:/zephyrproject/zephyr/soc/ambiq/Kconfig"
osource "C:/zephyrproject/zephyr/soc/aesc/Kconfig"
osource "C:/zephyrproject/zephyr/soc/adi/max32/Kconfig"
```

## APP_gfschuster/build/Kconfig/soc/Kconfig.defconfig
```kconfig
# Load Zephyr SoC defconfig descriptions.
osource "C:/zephyrproject/zephyr/soc/xlnx/zynqmp/Kconfig.defconfig"
osource "C:/zephyrproject/zephyr/soc/xlnx/zynq7000/Kconfig.defconfig"
osource "C:/zephyrproject/zephyr/soc/xlnx/versalnet/Kconfig.defconfig"
osource "C:/zephyrproject/zephyr/soc/xlnx/versal2/Kconfig.defconfig"
osource "C:/zephyrproject/zephyr/soc/xen/Kconfig.defconfig"
osource "C:/zephyrproject/zephyr/soc/wch/ch32v/Kconfig.defconfig"
osource "C:/zephyrproject/zephyr/soc/ti/simplelink/Kconfig.defconfig"
osource "C:/zephyrproject/zephyr/soc/ti/mspm0/Kconfig.defconfig"
osource "C:/zephyrproject/zephyr/soc/ti/lm3s6965/Kconfig.defconfig"
osource "C:/zephyrproject/zephyr/soc/ti/k3/Kconfig.defconfig"
osource "C:/zephyrproject/zephyr/soc/telink/tlsr/Kconfig.defconfig"
osource "C:/zephyrproject/zephyr/soc/starfive/jh71xx/Kconfig.defconfig"
osource "C:/zephyrproject/zephyr/soc/st/stm32/Kconfig.defconfig"
osource "C:/zephyrproject/zephyr/soc/snps/qemu_arc/Kconfig.defconfig"
osource "C:/zephyrproject/zephyr/soc/snps/nsim/arc_v/Kconfig.defconfig"
osource "C:/zephyrproject/zephyr/soc/snps/nsim/arc_classic/Kconfig.defconfig"
osource "C:/zephyrproject/zephyr/soc/snps/hsdk4xd/Kconfig.defconfig"
osource "C:/zephyrproject/zephyr/soc/snps/hsdk/Kconfig.defconfig"
osource "C:/zephyrproject/zephyr/soc/snps/emsk/Kconfig.defconfig"
osource "C:/zephyrproject/zephyr/soc/snps/emsdp/Kconfig.defconfig"
osource "C:/zephyrproject/zephyr/soc/snps/arc_iot/Kconfig.defconfig"
osource "C:/zephyrproject/zephyr/soc/silabs/Kconfig.defconfig"
osource "C:/zephyrproject/zephyr/soc/sifli/sf32/Kconfig.defconfig"
osource "C:/zephyrproject/zephyr/soc/sifive/sifive_freedom/Kconfig.defconfig"
osource "C:/zephyrproject/zephyr/soc/sensry/Kconfig.defconfig"
osource "C:/zephyrproject/zephyr/soc/rockchip/Kconfig.defconfig"
osource "C:/zephyrproject/zephyr/soc/renode/riscv_virtual/Kconfig.defconfig"
osource "C:/zephyrproject/zephyr/soc/renode/cortex_r8_virtual/Kconfig.defconfig"
osource "C:/zephyrproject/zephyr/soc/renesas/smartbond/Kconfig.defconfig"
osource "C:/zephyrproject/zephyr/soc/renesas/rz/Kconfig.defconfig"
osource "C:/zephyrproject/zephyr/soc/renesas/rx/Kconfig.defconfig"
osource "C:/zephyrproject/zephyr/soc/renesas/rcar/Kconfig.defconfig"
osource "C:/zephyrproject/zephyr/soc/renesas/ra/Kconfig.defconfig"
osource "C:/zephyrproject/zephyr/soc/realtek/ec/Kconfig.defconfig"
osource "C:/zephyrproject/zephyr/soc/raspberrypi/rpi_pico/Kconfig.defconfig"
osource "C:/zephyrproject/zephyr/soc/quicklogic/eos_s3/Kconfig.defconfig"
osource "C:/zephyrproject/zephyr/soc/qemu/virt_riscv/Kconfig.defconfig"
osource "C:/zephyrproject/zephyr/soc/qemu/malta/Kconfig.defconfig"
osource "C:/zephyrproject/zephyr/soc/openisa/rv32m1/Kconfig.defconfig"
osource "C:/zephyrproject/zephyr/soc/openhwgroup/cva6/Kconfig.defconfig"
osource "C:/zephyrproject/zephyr/soc/oct/osd32mp15x/Kconfig.defconfig"
osource "C:/zephyrproject/zephyr/soc/nxp/s32/Kconfig.defconfig"
osource "C:/zephyrproject/zephyr/soc/nxp/rw/Kconfig.defconfig"
osource "C:/zephyrproject/zephyr/soc/nxp/mcx/Kconfig.defconfig"
osource "C:/zephyrproject/zephyr/soc/nxp/lpc/Kconfig.defconfig"
osource "C:/zephyrproject/zephyr/soc/nxp/layerscape/Kconfig.defconfig"
osource "C:/zephyrproject/zephyr/soc/nxp/kinetis/Kconfig.defconfig"
osource "C:/zephyrproject/zephyr/soc/nxp/imxrt/Kconfig.defconfig"
osource "C:/zephyrproject/zephyr/soc/nxp/imx/Kconfig.defconfig"
osource "C:/zephyrproject/zephyr/soc/nuvoton/numicro/Kconfig.defconfig"
osource "C:/zephyrproject/zephyr/soc/nuvoton/numaker/Kconfig.defconfig"
osource "C:/zephyrproject/zephyr/soc/nuvoton/npcx/Kconfig.defconfig"
osource "C:/zephyrproject/zephyr/soc/nuvoton/npcm/Kconfig.defconfig"
osource "C:/zephyrproject/zephyr/soc/nordic/Kconfig.defconfig"
osource "C:/zephyrproject/zephyr/soc/neorv32/Kconfig.defconfig"
osource "C:/zephyrproject/zephyr/soc/native/inf_clock/Kconfig.defconfig"
osource "C:/zephyrproject/zephyr/soc/microchip/sam/Kconfig.defconfig"
osource "C:/zephyrproject/zephyr/soc/microchip/sam/sam_d5x_e5x/Kconfig.defconfig"
osource "C:/zephyrproject/zephyr/soc/microchip/pic32c/pic32cm_jh/Kconfig.defconfig"
osource "C:/zephyrproject/zephyr/soc/microchip/miv/Kconfig.defconfig"
osource "C:/zephyrproject/zephyr/soc/microchip/mec/Kconfig.defconfig"
osource "C:/zephyrproject/zephyr/soc/mediatek/mt8xxx/Kconfig.defconfig"
osource "C:/zephyrproject/zephyr/soc/lowrisc/opentitan/Kconfig.defconfig"
osource "C:/zephyrproject/zephyr/soc/litex/litex_vexriscv/Kconfig.defconfig"
osource "C:/zephyrproject/zephyr/soc/ite/ec/Kconfig.defconfig"
osource "C:/zephyrproject/zephyr/soc/intel/raptor_lake/Kconfig.defconfig"
osource "C:/zephyrproject/zephyr/soc/intel/panther_lake/Kconfig.defconfig"
osource "C:/zephyrproject/zephyr/soc/intel/lakemont/Kconfig.defconfig"
osource "C:/zephyrproject/zephyr/soc/intel/intel_socfpga_std/Kconfig.defconfig"
osource "C:/zephyrproject/zephyr/soc/intel/intel_socfpga/Kconfig.defconfig"
osource "C:/zephyrproject/zephyr/soc/intel/intel_niosv/Kconfig.defconfig"
osource "C:/zephyrproject/zephyr/soc/intel/intel_ish/Kconfig.defconfig"
osource "C:/zephyrproject/zephyr/soc/intel/intel_adsp/Kconfig.defconfig"
osource "C:/zephyrproject/zephyr/soc/intel/elkhart_lake/Kconfig.defconfig"
osource "C:/zephyrproject/zephyr/soc/intel/atom/Kconfig.defconfig"
osource "C:/zephyrproject/zephyr/soc/intel/apollo_lake/Kconfig.defconfig"
osource "C:/zephyrproject/zephyr/soc/intel/alder_lake/Kconfig.defconfig"
osource "C:/zephyrproject/zephyr/soc/infineon/cat3/Kconfig.defconfig"
osource "C:/zephyrproject/zephyr/soc/infineon/cat1c/Kconfig.defconfig"
osource "C:/zephyrproject/zephyr/soc/infineon/cat1b/Kconfig.defconfig"
osource "C:/zephyrproject/zephyr/soc/infineon/cat1a/Kconfig.defconfig"
osource "C:/zephyrproject/zephyr/soc/gd/gd32/Kconfig.defconfig"
osource "C:/zephyrproject/zephyr/soc/gaisler/leon3/Kconfig.defconfig"
osource "C:/zephyrproject/zephyr/soc/gaisler/gr716a/Kconfig.defconfig"
osource "C:/zephyrproject/zephyr/soc/espressif/Kconfig.defconfig"
osource "C:/zephyrproject/zephyr/soc/ene/kb1200/Kconfig.defconfig"
osource "C:/zephyrproject/zephyr/soc/ene/kb106x/Kconfig.defconfig"
osource "C:/zephyrproject/zephyr/soc/efinix/sapphire/Kconfig.defconfig"
osource "C:/zephyrproject/zephyr/soc/cdns/xtensa_sample_controller/Kconfig.defconfig"
osource "C:/zephyrproject/zephyr/soc/cdns/sample_controller32/Kconfig.defconfig"
osource "C:/zephyrproject/zephyr/soc/cdns/dc233c/Kconfig.defconfig"
osource "C:/zephyrproject/zephyr/soc/brcm/bcmvk/Kconfig.defconfig"
osource "C:/zephyrproject/zephyr/soc/brcm/bcm2712/Kconfig.defconfig"
osource "C:/zephyrproject/zephyr/soc/brcm/bcm2711/Kconfig.defconfig"
osource "C:/zephyrproject/zephyr/soc/bflb/Kconfig.defconfig"
osource "C:/zephyrproject/zephyr/soc/atmel/sam0/Kconfig.defconfig"
osource "C:/zephyrproject/zephyr/soc/atmel/sam/Kconfig.defconfig"
osource "C:/zephyrproject/zephyr/soc/aspeed/Kconfig.defconfig"
osource "C:/zephyrproject/zephyr/soc/arm/Kconfig.defconfig"
osource "C:/zephyrproject/zephyr/soc/arm/beetle/Kconfig.defconfig"
osource "C:/zephyrproject/zephyr/soc/antmicro/myra/Kconfig.defconfig"
osource "C:/zephyrproject/zephyr/soc/andestech/Kconfig.defconfig"
osource "C:/zephyrproject/zephyr/soc/amd/acp_6_0/Kconfig.defconfig"
osource "C:/zephyrproject/zephyr/soc/ambiq/Kconfig.defconfig"
osource "C:/zephyrproject/zephyr/soc/aesc/Kconfig.defconfig"
osource "C:/zephyrproject/zephyr/soc/adi/max32/Kconfig.defconfig"
```
